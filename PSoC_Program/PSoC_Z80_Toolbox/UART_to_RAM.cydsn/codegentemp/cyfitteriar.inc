;
; File Name: cyfitteriar.inc
; 
; PSoC Creator  4.4
;
; Description:
; 
;
;-------------------------------------------------------------------------------
; Copyright (c) 2007-2020 Cypress Semiconductor.  All rights reserved.
; You may use this file only in accordance with the license, terms, conditions, 
; disclaimers, and limitations in the end user license agreement accompanying 
; the software package with which this file was provided.
;-------------------------------------------------------------------------------

#ifndef INCLUDED_CYFITTERIAR_INC
#define INCLUDED_CYFITTERIAR_INC
    INCLUDE cydeviceiar.inc
    INCLUDE cydeviceiar_trm.inc

/* CS */
CS__0__INTTYPE EQU CYREG_PICU3_INTTYPE3
CS__0__MASK EQU 0x08
CS__0__PC EQU CYREG_PRT3_PC3
CS__0__PORT EQU 3
CS__0__SHIFT EQU 3
CS__AG EQU CYREG_PRT3_AG
CS__AMUX EQU CYREG_PRT3_AMUX
CS__BIE EQU CYREG_PRT3_BIE
CS__BIT_MASK EQU CYREG_PRT3_BIT_MASK
CS__BYP EQU CYREG_PRT3_BYP
CS__CTL EQU CYREG_PRT3_CTL
CS__DM0 EQU CYREG_PRT3_DM0
CS__DM1 EQU CYREG_PRT3_DM1
CS__DM2 EQU CYREG_PRT3_DM2
CS__DR EQU CYREG_PRT3_DR
CS__INP_DIS EQU CYREG_PRT3_INP_DIS
CS__INTTYPE_BASE EQU CYDEV_PICU_INTTYPE_PICU3_BASE
CS__LCD_COM_SEG EQU CYREG_PRT3_LCD_COM_SEG
CS__LCD_EN EQU CYREG_PRT3_LCD_EN
CS__MASK EQU 0x08
CS__PORT EQU 3
CS__PRT EQU CYREG_PRT3_PRT
CS__PRTDSI__CAPS_SEL EQU CYREG_PRT3_CAPS_SEL
CS__PRTDSI__DBL_SYNC_IN EQU CYREG_PRT3_DBL_SYNC_IN
CS__PRTDSI__OE_SEL0 EQU CYREG_PRT3_OE_SEL0
CS__PRTDSI__OE_SEL1 EQU CYREG_PRT3_OE_SEL1
CS__PRTDSI__OUT_SEL0 EQU CYREG_PRT3_OUT_SEL0
CS__PRTDSI__OUT_SEL1 EQU CYREG_PRT3_OUT_SEL1
CS__PRTDSI__SYNC_OUT EQU CYREG_PRT3_SYNC_OUT
CS__PS EQU CYREG_PRT3_PS
CS__SHIFT EQU 3
CS__SLW EQU CYREG_PRT3_SLW

/* Data */
Data__0__INTTYPE EQU CYREG_PICU0_INTTYPE0
Data__0__MASK EQU 0x01
Data__0__PC EQU CYREG_PRT0_PC0
Data__0__PORT EQU 0
Data__0__SHIFT EQU 0
Data__1__INTTYPE EQU CYREG_PICU0_INTTYPE1
Data__1__MASK EQU 0x02
Data__1__PC EQU CYREG_PRT0_PC1
Data__1__PORT EQU 0
Data__1__SHIFT EQU 1
Data__2__INTTYPE EQU CYREG_PICU0_INTTYPE2
Data__2__MASK EQU 0x04
Data__2__PC EQU CYREG_PRT0_PC2
Data__2__PORT EQU 0
Data__2__SHIFT EQU 2
Data__3__INTTYPE EQU CYREG_PICU0_INTTYPE3
Data__3__MASK EQU 0x08
Data__3__PC EQU CYREG_PRT0_PC3
Data__3__PORT EQU 0
Data__3__SHIFT EQU 3
Data__4__INTTYPE EQU CYREG_PICU0_INTTYPE4
Data__4__MASK EQU 0x10
Data__4__PC EQU CYREG_PRT0_PC4
Data__4__PORT EQU 0
Data__4__SHIFT EQU 4
Data__5__INTTYPE EQU CYREG_PICU0_INTTYPE5
Data__5__MASK EQU 0x20
Data__5__PC EQU CYREG_PRT0_PC5
Data__5__PORT EQU 0
Data__5__SHIFT EQU 5
Data__6__INTTYPE EQU CYREG_PICU0_INTTYPE6
Data__6__MASK EQU 0x40
Data__6__PC EQU CYREG_PRT0_PC6
Data__6__PORT EQU 0
Data__6__SHIFT EQU 6
Data__7__INTTYPE EQU CYREG_PICU0_INTTYPE7
Data__7__MASK EQU 0x80
Data__7__PC EQU CYREG_PRT0_PC7
Data__7__PORT EQU 0
Data__7__SHIFT EQU 7
Data__AG EQU CYREG_PRT0_AG
Data__AMUX EQU CYREG_PRT0_AMUX
Data__BIE EQU CYREG_PRT0_BIE
Data__BIT_MASK EQU CYREG_PRT0_BIT_MASK
Data__BYP EQU CYREG_PRT0_BYP
Data__CTL EQU CYREG_PRT0_CTL
Data__DM0 EQU CYREG_PRT0_DM0
Data__DM1 EQU CYREG_PRT0_DM1
Data__DM2 EQU CYREG_PRT0_DM2
Data__DR EQU CYREG_PRT0_DR
Data__INP_DIS EQU CYREG_PRT0_INP_DIS
Data__INTTYPE_BASE EQU CYDEV_PICU_INTTYPE_PICU0_BASE
Data__LCD_COM_SEG EQU CYREG_PRT0_LCD_COM_SEG
Data__LCD_EN EQU CYREG_PRT0_LCD_EN
Data__MASK EQU 0xFF
Data__PORT EQU 0
Data__PRT EQU CYREG_PRT0_PRT
Data__PRTDSI__CAPS_SEL EQU CYREG_PRT0_CAPS_SEL
Data__PRTDSI__DBL_SYNC_IN EQU CYREG_PRT0_DBL_SYNC_IN
Data__PRTDSI__OE_SEL0 EQU CYREG_PRT0_OE_SEL0
Data__PRTDSI__OE_SEL1 EQU CYREG_PRT0_OE_SEL1
Data__PRTDSI__OUT_SEL0 EQU CYREG_PRT0_OUT_SEL0
Data__PRTDSI__OUT_SEL1 EQU CYREG_PRT0_OUT_SEL1
Data__PRTDSI__SYNC_OUT EQU CYREG_PRT0_SYNC_OUT
Data__PS EQU CYREG_PRT0_PS
Data__SHIFT EQU 0
Data__SLW EQU CYREG_PRT0_SLW

/* Read */
Read__0__INTTYPE EQU CYREG_PICU3_INTTYPE4
Read__0__MASK EQU 0x10
Read__0__PC EQU CYREG_PRT3_PC4
Read__0__PORT EQU 3
Read__0__SHIFT EQU 4
Read__AG EQU CYREG_PRT3_AG
Read__AMUX EQU CYREG_PRT3_AMUX
Read__BIE EQU CYREG_PRT3_BIE
Read__BIT_MASK EQU CYREG_PRT3_BIT_MASK
Read__BYP EQU CYREG_PRT3_BYP
Read__CTL EQU CYREG_PRT3_CTL
Read__DM0 EQU CYREG_PRT3_DM0
Read__DM1 EQU CYREG_PRT3_DM1
Read__DM2 EQU CYREG_PRT3_DM2
Read__DR EQU CYREG_PRT3_DR
Read__INP_DIS EQU CYREG_PRT3_INP_DIS
Read__INTTYPE_BASE EQU CYDEV_PICU_INTTYPE_PICU3_BASE
Read__LCD_COM_SEG EQU CYREG_PRT3_LCD_COM_SEG
Read__LCD_EN EQU CYREG_PRT3_LCD_EN
Read__MASK EQU 0x10
Read__PORT EQU 3
Read__PRT EQU CYREG_PRT3_PRT
Read__PRTDSI__CAPS_SEL EQU CYREG_PRT3_CAPS_SEL
Read__PRTDSI__DBL_SYNC_IN EQU CYREG_PRT3_DBL_SYNC_IN
Read__PRTDSI__OE_SEL0 EQU CYREG_PRT3_OE_SEL0
Read__PRTDSI__OE_SEL1 EQU CYREG_PRT3_OE_SEL1
Read__PRTDSI__OUT_SEL0 EQU CYREG_PRT3_OUT_SEL0
Read__PRTDSI__OUT_SEL1 EQU CYREG_PRT3_OUT_SEL1
Read__PRTDSI__SYNC_OUT EQU CYREG_PRT3_SYNC_OUT
Read__PS EQU CYREG_PRT3_PS
Read__SHIFT EQU 4
Read__SLW EQU CYREG_PRT3_SLW

/* Rx_1 */
Rx_1__0__INTTYPE EQU CYREG_PICU2_INTTYPE0
Rx_1__0__MASK EQU 0x01
Rx_1__0__PC EQU CYREG_PRT2_PC0
Rx_1__0__PORT EQU 2
Rx_1__0__SHIFT EQU 0
Rx_1__AG EQU CYREG_PRT2_AG
Rx_1__AMUX EQU CYREG_PRT2_AMUX
Rx_1__BIE EQU CYREG_PRT2_BIE
Rx_1__BIT_MASK EQU CYREG_PRT2_BIT_MASK
Rx_1__BYP EQU CYREG_PRT2_BYP
Rx_1__CTL EQU CYREG_PRT2_CTL
Rx_1__DM0 EQU CYREG_PRT2_DM0
Rx_1__DM1 EQU CYREG_PRT2_DM1
Rx_1__DM2 EQU CYREG_PRT2_DM2
Rx_1__DR EQU CYREG_PRT2_DR
Rx_1__INP_DIS EQU CYREG_PRT2_INP_DIS
Rx_1__INTTYPE_BASE EQU CYDEV_PICU_INTTYPE_PICU2_BASE
Rx_1__LCD_COM_SEG EQU CYREG_PRT2_LCD_COM_SEG
Rx_1__LCD_EN EQU CYREG_PRT2_LCD_EN
Rx_1__MASK EQU 0x01
Rx_1__PORT EQU 2
Rx_1__PRT EQU CYREG_PRT2_PRT
Rx_1__PRTDSI__CAPS_SEL EQU CYREG_PRT2_CAPS_SEL
Rx_1__PRTDSI__DBL_SYNC_IN EQU CYREG_PRT2_DBL_SYNC_IN
Rx_1__PRTDSI__OE_SEL0 EQU CYREG_PRT2_OE_SEL0
Rx_1__PRTDSI__OE_SEL1 EQU CYREG_PRT2_OE_SEL1
Rx_1__PRTDSI__OUT_SEL0 EQU CYREG_PRT2_OUT_SEL0
Rx_1__PRTDSI__OUT_SEL1 EQU CYREG_PRT2_OUT_SEL1
Rx_1__PRTDSI__SYNC_OUT EQU CYREG_PRT2_SYNC_OUT
Rx_1__PS EQU CYREG_PRT2_PS
Rx_1__SHIFT EQU 0
Rx_1__SLW EQU CYREG_PRT2_SLW

/* Tx_1 */
Tx_1__0__INTTYPE EQU CYREG_PICU2_INTTYPE1
Tx_1__0__MASK EQU 0x02
Tx_1__0__PC EQU CYREG_PRT2_PC1
Tx_1__0__PORT EQU 2
Tx_1__0__SHIFT EQU 1
Tx_1__AG EQU CYREG_PRT2_AG
Tx_1__AMUX EQU CYREG_PRT2_AMUX
Tx_1__BIE EQU CYREG_PRT2_BIE
Tx_1__BIT_MASK EQU CYREG_PRT2_BIT_MASK
Tx_1__BYP EQU CYREG_PRT2_BYP
Tx_1__CTL EQU CYREG_PRT2_CTL
Tx_1__DM0 EQU CYREG_PRT2_DM0
Tx_1__DM1 EQU CYREG_PRT2_DM1
Tx_1__DM2 EQU CYREG_PRT2_DM2
Tx_1__DR EQU CYREG_PRT2_DR
Tx_1__INP_DIS EQU CYREG_PRT2_INP_DIS
Tx_1__INTTYPE_BASE EQU CYDEV_PICU_INTTYPE_PICU2_BASE
Tx_1__LCD_COM_SEG EQU CYREG_PRT2_LCD_COM_SEG
Tx_1__LCD_EN EQU CYREG_PRT2_LCD_EN
Tx_1__MASK EQU 0x02
Tx_1__PORT EQU 2
Tx_1__PRT EQU CYREG_PRT2_PRT
Tx_1__PRTDSI__CAPS_SEL EQU CYREG_PRT2_CAPS_SEL
Tx_1__PRTDSI__DBL_SYNC_IN EQU CYREG_PRT2_DBL_SYNC_IN
Tx_1__PRTDSI__OE_SEL0 EQU CYREG_PRT2_OE_SEL0
Tx_1__PRTDSI__OE_SEL1 EQU CYREG_PRT2_OE_SEL1
Tx_1__PRTDSI__OUT_SEL0 EQU CYREG_PRT2_OUT_SEL0
Tx_1__PRTDSI__OUT_SEL1 EQU CYREG_PRT2_OUT_SEL1
Tx_1__PRTDSI__SYNC_OUT EQU CYREG_PRT2_SYNC_OUT
Tx_1__PS EQU CYREG_PRT2_PS
Tx_1__SHIFT EQU 1
Tx_1__SLW EQU CYREG_PRT2_SLW

/* UART */
UART_BUART_sRX_RxBitCounter__16BIT_CONTROL_AUX_CTL_REG EQU CYREG_B0_UDB13_14_ACTL
UART_BUART_sRX_RxBitCounter__16BIT_CONTROL_CONTROL_REG EQU CYREG_B0_UDB13_14_CTL
UART_BUART_sRX_RxBitCounter__16BIT_CONTROL_COUNT_REG EQU CYREG_B0_UDB13_14_CTL
UART_BUART_sRX_RxBitCounter__16BIT_COUNT_CONTROL_REG EQU CYREG_B0_UDB13_14_CTL
UART_BUART_sRX_RxBitCounter__16BIT_COUNT_COUNT_REG EQU CYREG_B0_UDB13_14_CTL
UART_BUART_sRX_RxBitCounter__16BIT_MASK_MASK_REG EQU CYREG_B0_UDB13_14_MSK
UART_BUART_sRX_RxBitCounter__16BIT_MASK_PERIOD_REG EQU CYREG_B0_UDB13_14_MSK
UART_BUART_sRX_RxBitCounter__16BIT_PERIOD_MASK_REG EQU CYREG_B0_UDB13_14_MSK
UART_BUART_sRX_RxBitCounter__16BIT_PERIOD_PERIOD_REG EQU CYREG_B0_UDB13_14_MSK
UART_BUART_sRX_RxBitCounter__CONTROL_AUX_CTL_REG EQU CYREG_B0_UDB13_ACTL
UART_BUART_sRX_RxBitCounter__CONTROL_REG EQU CYREG_B0_UDB13_CTL
UART_BUART_sRX_RxBitCounter__CONTROL_ST_REG EQU CYREG_B0_UDB13_ST_CTL
UART_BUART_sRX_RxBitCounter__COUNT_REG EQU CYREG_B0_UDB13_CTL
UART_BUART_sRX_RxBitCounter__COUNT_ST_REG EQU CYREG_B0_UDB13_ST_CTL
UART_BUART_sRX_RxBitCounter__MASK_CTL_AUX_CTL_REG EQU CYREG_B0_UDB13_MSK_ACTL
UART_BUART_sRX_RxBitCounter__PER_CTL_AUX_CTL_REG EQU CYREG_B0_UDB13_MSK_ACTL
UART_BUART_sRX_RxBitCounter__PERIOD_REG EQU CYREG_B0_UDB13_MSK
UART_BUART_sRX_RxBitCounter_ST__16BIT_STATUS_AUX_CTL_REG EQU CYREG_B0_UDB13_14_ACTL
UART_BUART_sRX_RxBitCounter_ST__16BIT_STATUS_REG EQU CYREG_B0_UDB13_14_ST
UART_BUART_sRX_RxBitCounter_ST__MASK_REG EQU CYREG_B0_UDB13_MSK
UART_BUART_sRX_RxBitCounter_ST__MASK_ST_AUX_CTL_REG EQU CYREG_B0_UDB13_MSK_ACTL
UART_BUART_sRX_RxBitCounter_ST__PER_ST_AUX_CTL_REG EQU CYREG_B0_UDB13_MSK_ACTL
UART_BUART_sRX_RxBitCounter_ST__STATUS_AUX_CTL_REG EQU CYREG_B0_UDB13_ACTL
UART_BUART_sRX_RxBitCounter_ST__STATUS_CNT_REG EQU CYREG_B0_UDB13_ST_CTL
UART_BUART_sRX_RxBitCounter_ST__STATUS_CONTROL_REG EQU CYREG_B0_UDB13_ST_CTL
UART_BUART_sRX_RxBitCounter_ST__STATUS_REG EQU CYREG_B0_UDB13_ST
UART_BUART_sRX_RxShifter_u0__16BIT_A0_REG EQU CYREG_B0_UDB13_14_A0
UART_BUART_sRX_RxShifter_u0__16BIT_A1_REG EQU CYREG_B0_UDB13_14_A1
UART_BUART_sRX_RxShifter_u0__16BIT_D0_REG EQU CYREG_B0_UDB13_14_D0
UART_BUART_sRX_RxShifter_u0__16BIT_D1_REG EQU CYREG_B0_UDB13_14_D1
UART_BUART_sRX_RxShifter_u0__16BIT_DP_AUX_CTL_REG EQU CYREG_B0_UDB13_14_ACTL
UART_BUART_sRX_RxShifter_u0__16BIT_F0_REG EQU CYREG_B0_UDB13_14_F0
UART_BUART_sRX_RxShifter_u0__16BIT_F1_REG EQU CYREG_B0_UDB13_14_F1
UART_BUART_sRX_RxShifter_u0__A0_A1_REG EQU CYREG_B0_UDB13_A0_A1
UART_BUART_sRX_RxShifter_u0__A0_REG EQU CYREG_B0_UDB13_A0
UART_BUART_sRX_RxShifter_u0__A1_REG EQU CYREG_B0_UDB13_A1
UART_BUART_sRX_RxShifter_u0__D0_D1_REG EQU CYREG_B0_UDB13_D0_D1
UART_BUART_sRX_RxShifter_u0__D0_REG EQU CYREG_B0_UDB13_D0
UART_BUART_sRX_RxShifter_u0__D1_REG EQU CYREG_B0_UDB13_D1
UART_BUART_sRX_RxShifter_u0__DP_AUX_CTL_REG EQU CYREG_B0_UDB13_ACTL
UART_BUART_sRX_RxShifter_u0__F0_F1_REG EQU CYREG_B0_UDB13_F0_F1
UART_BUART_sRX_RxShifter_u0__F0_REG EQU CYREG_B0_UDB13_F0
UART_BUART_sRX_RxShifter_u0__F1_REG EQU CYREG_B0_UDB13_F1
UART_BUART_sRX_RxShifter_u0__MSK_DP_AUX_CTL_REG EQU CYREG_B0_UDB13_MSK_ACTL
UART_BUART_sRX_RxShifter_u0__PER_DP_AUX_CTL_REG EQU CYREG_B0_UDB13_MSK_ACTL
UART_BUART_sRX_RxSts__16BIT_STATUS_AUX_CTL_REG EQU CYREG_B0_UDB12_13_ACTL
UART_BUART_sRX_RxSts__16BIT_STATUS_REG EQU CYREG_B0_UDB12_13_ST
UART_BUART_sRX_RxSts__3__MASK EQU 0x08
UART_BUART_sRX_RxSts__3__POS EQU 3
UART_BUART_sRX_RxSts__4__MASK EQU 0x10
UART_BUART_sRX_RxSts__4__POS EQU 4
UART_BUART_sRX_RxSts__5__MASK EQU 0x20
UART_BUART_sRX_RxSts__5__POS EQU 5
UART_BUART_sRX_RxSts__MASK EQU 0x38
UART_BUART_sRX_RxSts__MASK_REG EQU CYREG_B0_UDB12_MSK
UART_BUART_sRX_RxSts__STATUS_AUX_CTL_REG EQU CYREG_B0_UDB12_ACTL
UART_BUART_sRX_RxSts__STATUS_REG EQU CYREG_B0_UDB12_ST
UART_BUART_sTX_sCLOCK_TxBitClkGen__A0_A1_REG EQU CYREG_B0_UDB15_A0_A1
UART_BUART_sTX_sCLOCK_TxBitClkGen__A0_REG EQU CYREG_B0_UDB15_A0
UART_BUART_sTX_sCLOCK_TxBitClkGen__A1_REG EQU CYREG_B0_UDB15_A1
UART_BUART_sTX_sCLOCK_TxBitClkGen__D0_D1_REG EQU CYREG_B0_UDB15_D0_D1
UART_BUART_sTX_sCLOCK_TxBitClkGen__D0_REG EQU CYREG_B0_UDB15_D0
UART_BUART_sTX_sCLOCK_TxBitClkGen__D1_REG EQU CYREG_B0_UDB15_D1
UART_BUART_sTX_sCLOCK_TxBitClkGen__DP_AUX_CTL_REG EQU CYREG_B0_UDB15_ACTL
UART_BUART_sTX_sCLOCK_TxBitClkGen__F0_F1_REG EQU CYREG_B0_UDB15_F0_F1
UART_BUART_sTX_sCLOCK_TxBitClkGen__F0_REG EQU CYREG_B0_UDB15_F0
UART_BUART_sTX_sCLOCK_TxBitClkGen__F1_REG EQU CYREG_B0_UDB15_F1
UART_BUART_sTX_TxShifter_u0__16BIT_A0_REG EQU CYREG_B0_UDB14_15_A0
UART_BUART_sTX_TxShifter_u0__16BIT_A1_REG EQU CYREG_B0_UDB14_15_A1
UART_BUART_sTX_TxShifter_u0__16BIT_D0_REG EQU CYREG_B0_UDB14_15_D0
UART_BUART_sTX_TxShifter_u0__16BIT_D1_REG EQU CYREG_B0_UDB14_15_D1
UART_BUART_sTX_TxShifter_u0__16BIT_DP_AUX_CTL_REG EQU CYREG_B0_UDB14_15_ACTL
UART_BUART_sTX_TxShifter_u0__16BIT_F0_REG EQU CYREG_B0_UDB14_15_F0
UART_BUART_sTX_TxShifter_u0__16BIT_F1_REG EQU CYREG_B0_UDB14_15_F1
UART_BUART_sTX_TxShifter_u0__A0_A1_REG EQU CYREG_B0_UDB14_A0_A1
UART_BUART_sTX_TxShifter_u0__A0_REG EQU CYREG_B0_UDB14_A0
UART_BUART_sTX_TxShifter_u0__A1_REG EQU CYREG_B0_UDB14_A1
UART_BUART_sTX_TxShifter_u0__D0_D1_REG EQU CYREG_B0_UDB14_D0_D1
UART_BUART_sTX_TxShifter_u0__D0_REG EQU CYREG_B0_UDB14_D0
UART_BUART_sTX_TxShifter_u0__D1_REG EQU CYREG_B0_UDB14_D1
UART_BUART_sTX_TxShifter_u0__DP_AUX_CTL_REG EQU CYREG_B0_UDB14_ACTL
UART_BUART_sTX_TxShifter_u0__F0_F1_REG EQU CYREG_B0_UDB14_F0_F1
UART_BUART_sTX_TxShifter_u0__F0_REG EQU CYREG_B0_UDB14_F0
UART_BUART_sTX_TxShifter_u0__F1_REG EQU CYREG_B0_UDB14_F1
UART_BUART_sTX_TxSts__0__MASK EQU 0x01
UART_BUART_sTX_TxSts__0__POS EQU 0
UART_BUART_sTX_TxSts__1__MASK EQU 0x02
UART_BUART_sTX_TxSts__1__POS EQU 1
UART_BUART_sTX_TxSts__16BIT_STATUS_AUX_CTL_REG EQU CYREG_B0_UDB14_15_ACTL
UART_BUART_sTX_TxSts__16BIT_STATUS_REG EQU CYREG_B0_UDB14_15_ST
UART_BUART_sTX_TxSts__2__MASK EQU 0x04
UART_BUART_sTX_TxSts__2__POS EQU 2
UART_BUART_sTX_TxSts__3__MASK EQU 0x08
UART_BUART_sTX_TxSts__3__POS EQU 3
UART_BUART_sTX_TxSts__MASK EQU 0x0F
UART_BUART_sTX_TxSts__MASK_REG EQU CYREG_B0_UDB14_MSK
UART_BUART_sTX_TxSts__STATUS_AUX_CTL_REG EQU CYREG_B0_UDB14_ACTL
UART_BUART_sTX_TxSts__STATUS_REG EQU CYREG_B0_UDB14_ST
UART_IntClock__CFG0 EQU CYREG_CLKDIST_DCFG0_CFG0
UART_IntClock__CFG1 EQU CYREG_CLKDIST_DCFG0_CFG1
UART_IntClock__CFG2 EQU CYREG_CLKDIST_DCFG0_CFG2
UART_IntClock__CFG2_SRC_SEL_MASK EQU 0x07
UART_IntClock__INDEX EQU 0x00
UART_IntClock__PM_ACT_CFG EQU CYREG_PM_ACT_CFG2
UART_IntClock__PM_ACT_MSK EQU 0x01
UART_IntClock__PM_STBY_CFG EQU CYREG_PM_STBY_CFG2
UART_IntClock__PM_STBY_MSK EQU 0x01

/* Write */
Write__0__INTTYPE EQU CYREG_PICU3_INTTYPE5
Write__0__MASK EQU 0x20
Write__0__PC EQU CYREG_PRT3_PC5
Write__0__PORT EQU 3
Write__0__SHIFT EQU 5
Write__AG EQU CYREG_PRT3_AG
Write__AMUX EQU CYREG_PRT3_AMUX
Write__BIE EQU CYREG_PRT3_BIE
Write__BIT_MASK EQU CYREG_PRT3_BIT_MASK
Write__BYP EQU CYREG_PRT3_BYP
Write__CTL EQU CYREG_PRT3_CTL
Write__DM0 EQU CYREG_PRT3_DM0
Write__DM1 EQU CYREG_PRT3_DM1
Write__DM2 EQU CYREG_PRT3_DM2
Write__DR EQU CYREG_PRT3_DR
Write__INP_DIS EQU CYREG_PRT3_INP_DIS
Write__INTTYPE_BASE EQU CYDEV_PICU_INTTYPE_PICU3_BASE
Write__LCD_COM_SEG EQU CYREG_PRT3_LCD_COM_SEG
Write__LCD_EN EQU CYREG_PRT3_LCD_EN
Write__MASK EQU 0x20
Write__PORT EQU 3
Write__PRT EQU CYREG_PRT3_PRT
Write__PRTDSI__CAPS_SEL EQU CYREG_PRT3_CAPS_SEL
Write__PRTDSI__DBL_SYNC_IN EQU CYREG_PRT3_DBL_SYNC_IN
Write__PRTDSI__OE_SEL0 EQU CYREG_PRT3_OE_SEL0
Write__PRTDSI__OE_SEL1 EQU CYREG_PRT3_OE_SEL1
Write__PRTDSI__OUT_SEL0 EQU CYREG_PRT3_OUT_SEL0
Write__PRTDSI__OUT_SEL1 EQU CYREG_PRT3_OUT_SEL1
Write__PRTDSI__SYNC_OUT EQU CYREG_PRT3_SYNC_OUT
Write__PS EQU CYREG_PRT3_PS
Write__SHIFT EQU 5
Write__SLW EQU CYREG_PRT3_SLW

/* Address_LSB */
Address_LSB__0__INTTYPE EQU CYREG_PICU5_INTTYPE0
Address_LSB__0__MASK EQU 0x01
Address_LSB__0__PC EQU CYREG_PRT5_PC0
Address_LSB__0__PORT EQU 5
Address_LSB__0__SHIFT EQU 0
Address_LSB__1__INTTYPE EQU CYREG_PICU5_INTTYPE1
Address_LSB__1__MASK EQU 0x02
Address_LSB__1__PC EQU CYREG_PRT5_PC1
Address_LSB__1__PORT EQU 5
Address_LSB__1__SHIFT EQU 1
Address_LSB__2__INTTYPE EQU CYREG_PICU5_INTTYPE2
Address_LSB__2__MASK EQU 0x04
Address_LSB__2__PC EQU CYREG_PRT5_PC2
Address_LSB__2__PORT EQU 5
Address_LSB__2__SHIFT EQU 2
Address_LSB__3__INTTYPE EQU CYREG_PICU5_INTTYPE3
Address_LSB__3__MASK EQU 0x08
Address_LSB__3__PC EQU CYREG_PRT5_PC3
Address_LSB__3__PORT EQU 5
Address_LSB__3__SHIFT EQU 3
Address_LSB__4__INTTYPE EQU CYREG_PICU5_INTTYPE4
Address_LSB__4__MASK EQU 0x10
Address_LSB__4__PC EQU CYREG_PRT5_PC4
Address_LSB__4__PORT EQU 5
Address_LSB__4__SHIFT EQU 4
Address_LSB__5__INTTYPE EQU CYREG_PICU5_INTTYPE5
Address_LSB__5__MASK EQU 0x20
Address_LSB__5__PC EQU CYREG_PRT5_PC5
Address_LSB__5__PORT EQU 5
Address_LSB__5__SHIFT EQU 5
Address_LSB__6__INTTYPE EQU CYREG_PICU5_INTTYPE6
Address_LSB__6__MASK EQU 0x40
Address_LSB__6__PC EQU CYREG_PRT5_PC6
Address_LSB__6__PORT EQU 5
Address_LSB__6__SHIFT EQU 6
Address_LSB__7__INTTYPE EQU CYREG_PICU5_INTTYPE7
Address_LSB__7__MASK EQU 0x80
Address_LSB__7__PC EQU CYREG_PRT5_PC7
Address_LSB__7__PORT EQU 5
Address_LSB__7__SHIFT EQU 7
Address_LSB__AG EQU CYREG_PRT5_AG
Address_LSB__AMUX EQU CYREG_PRT5_AMUX
Address_LSB__BIE EQU CYREG_PRT5_BIE
Address_LSB__BIT_MASK EQU CYREG_PRT5_BIT_MASK
Address_LSB__BYP EQU CYREG_PRT5_BYP
Address_LSB__CTL EQU CYREG_PRT5_CTL
Address_LSB__DM0 EQU CYREG_PRT5_DM0
Address_LSB__DM1 EQU CYREG_PRT5_DM1
Address_LSB__DM2 EQU CYREG_PRT5_DM2
Address_LSB__DR EQU CYREG_PRT5_DR
Address_LSB__INP_DIS EQU CYREG_PRT5_INP_DIS
Address_LSB__INTTYPE_BASE EQU CYDEV_PICU_INTTYPE_PICU5_BASE
Address_LSB__LCD_COM_SEG EQU CYREG_PRT5_LCD_COM_SEG
Address_LSB__LCD_EN EQU CYREG_PRT5_LCD_EN
Address_LSB__MASK EQU 0xFF
Address_LSB__PORT EQU 5
Address_LSB__PRT EQU CYREG_PRT5_PRT
Address_LSB__PRTDSI__CAPS_SEL EQU CYREG_PRT5_CAPS_SEL
Address_LSB__PRTDSI__DBL_SYNC_IN EQU CYREG_PRT5_DBL_SYNC_IN
Address_LSB__PRTDSI__OE_SEL0 EQU CYREG_PRT5_OE_SEL0
Address_LSB__PRTDSI__OE_SEL1 EQU CYREG_PRT5_OE_SEL1
Address_LSB__PRTDSI__OUT_SEL0 EQU CYREG_PRT5_OUT_SEL0
Address_LSB__PRTDSI__OUT_SEL1 EQU CYREG_PRT5_OUT_SEL1
Address_LSB__PRTDSI__SYNC_OUT EQU CYREG_PRT5_SYNC_OUT
Address_LSB__PS EQU CYREG_PRT5_PS
Address_LSB__SHIFT EQU 0
Address_LSB__SLW EQU CYREG_PRT5_SLW

/* Address_MSB */
Address_MSB__0__INTTYPE EQU CYREG_PICU3_INTTYPE0
Address_MSB__0__MASK EQU 0x01
Address_MSB__0__PC EQU CYREG_PRT3_PC0
Address_MSB__0__PORT EQU 3
Address_MSB__0__SHIFT EQU 0
Address_MSB__1__INTTYPE EQU CYREG_PICU3_INTTYPE1
Address_MSB__1__MASK EQU 0x02
Address_MSB__1__PC EQU CYREG_PRT3_PC1
Address_MSB__1__PORT EQU 3
Address_MSB__1__SHIFT EQU 1
Address_MSB__2__INTTYPE EQU CYREG_PICU3_INTTYPE2
Address_MSB__2__MASK EQU 0x04
Address_MSB__2__PC EQU CYREG_PRT3_PC2
Address_MSB__2__PORT EQU 3
Address_MSB__2__SHIFT EQU 2
Address_MSB__AG EQU CYREG_PRT3_AG
Address_MSB__AMUX EQU CYREG_PRT3_AMUX
Address_MSB__BIE EQU CYREG_PRT3_BIE
Address_MSB__BIT_MASK EQU CYREG_PRT3_BIT_MASK
Address_MSB__BYP EQU CYREG_PRT3_BYP
Address_MSB__CTL EQU CYREG_PRT3_CTL
Address_MSB__DM0 EQU CYREG_PRT3_DM0
Address_MSB__DM1 EQU CYREG_PRT3_DM1
Address_MSB__DM2 EQU CYREG_PRT3_DM2
Address_MSB__DR EQU CYREG_PRT3_DR
Address_MSB__INP_DIS EQU CYREG_PRT3_INP_DIS
Address_MSB__INTTYPE_BASE EQU CYDEV_PICU_INTTYPE_PICU3_BASE
Address_MSB__LCD_COM_SEG EQU CYREG_PRT3_LCD_COM_SEG
Address_MSB__LCD_EN EQU CYREG_PRT3_LCD_EN
Address_MSB__MASK EQU 0x07
Address_MSB__PORT EQU 3
Address_MSB__PRT EQU CYREG_PRT3_PRT
Address_MSB__PRTDSI__CAPS_SEL EQU CYREG_PRT3_CAPS_SEL
Address_MSB__PRTDSI__DBL_SYNC_IN EQU CYREG_PRT3_DBL_SYNC_IN
Address_MSB__PRTDSI__OE_SEL0 EQU CYREG_PRT3_OE_SEL0
Address_MSB__PRTDSI__OE_SEL1 EQU CYREG_PRT3_OE_SEL1
Address_MSB__PRTDSI__OUT_SEL0 EQU CYREG_PRT3_OUT_SEL0
Address_MSB__PRTDSI__OUT_SEL1 EQU CYREG_PRT3_OUT_SEL1
Address_MSB__PRTDSI__SYNC_OUT EQU CYREG_PRT3_SYNC_OUT
Address_MSB__PS EQU CYREG_PRT3_PS
Address_MSB__SHIFT EQU 0
Address_MSB__SLW EQU CYREG_PRT3_SLW

/* Miscellaneous */
BCLK__BUS_CLK__HZ EQU 24000000
BCLK__BUS_CLK__KHZ EQU 24000
BCLK__BUS_CLK__MHZ EQU 24
CYDEV_CHIP_DIE_LEOPARD EQU 1
CYDEV_CHIP_DIE_PSOC4A EQU 26
CYDEV_CHIP_DIE_PSOC5LP EQU 2
CYDEV_CHIP_DIE_PSOC5TM EQU 3
CYDEV_CHIP_DIE_TMA4 EQU 4
CYDEV_CHIP_DIE_UNKNOWN EQU 0
CYDEV_CHIP_FAMILY_FM0P EQU 5
CYDEV_CHIP_FAMILY_FM3 EQU 6
CYDEV_CHIP_FAMILY_FM4 EQU 7
CYDEV_CHIP_FAMILY_PSOC3 EQU 1
CYDEV_CHIP_FAMILY_PSOC4 EQU 2
CYDEV_CHIP_FAMILY_PSOC5 EQU 3
CYDEV_CHIP_FAMILY_PSOC6 EQU 4
CYDEV_CHIP_FAMILY_UNKNOWN EQU 0
CYDEV_CHIP_FAMILY_USED EQU CYDEV_CHIP_FAMILY_PSOC5
CYDEV_CHIP_JTAG_ID EQU 0x2E160069
CYDEV_CHIP_MEMBER_3A EQU 1
CYDEV_CHIP_MEMBER_4A EQU 26
CYDEV_CHIP_MEMBER_4AA EQU 25
CYDEV_CHIP_MEMBER_4AB EQU 30
CYDEV_CHIP_MEMBER_4AC EQU 14
CYDEV_CHIP_MEMBER_4AD EQU 15
CYDEV_CHIP_MEMBER_4AE EQU 16
CYDEV_CHIP_MEMBER_4D EQU 20
CYDEV_CHIP_MEMBER_4E EQU 6
CYDEV_CHIP_MEMBER_4F EQU 27
CYDEV_CHIP_MEMBER_4G EQU 4
CYDEV_CHIP_MEMBER_4H EQU 24
CYDEV_CHIP_MEMBER_4I EQU 32
CYDEV_CHIP_MEMBER_4J EQU 21
CYDEV_CHIP_MEMBER_4K EQU 22
CYDEV_CHIP_MEMBER_4L EQU 31
CYDEV_CHIP_MEMBER_4M EQU 29
CYDEV_CHIP_MEMBER_4N EQU 11
CYDEV_CHIP_MEMBER_4O EQU 8
CYDEV_CHIP_MEMBER_4P EQU 28
CYDEV_CHIP_MEMBER_4Q EQU 17
CYDEV_CHIP_MEMBER_4R EQU 9
CYDEV_CHIP_MEMBER_4S EQU 12
CYDEV_CHIP_MEMBER_4T EQU 10
CYDEV_CHIP_MEMBER_4U EQU 5
CYDEV_CHIP_MEMBER_4V EQU 23
CYDEV_CHIP_MEMBER_4W EQU 13
CYDEV_CHIP_MEMBER_4X EQU 7
CYDEV_CHIP_MEMBER_4Y EQU 18
CYDEV_CHIP_MEMBER_4Z EQU 19
CYDEV_CHIP_MEMBER_5A EQU 3
CYDEV_CHIP_MEMBER_5B EQU 2
CYDEV_CHIP_MEMBER_6A EQU 33
CYDEV_CHIP_MEMBER_FM3 EQU 37
CYDEV_CHIP_MEMBER_FM4 EQU 38
CYDEV_CHIP_MEMBER_PDL_FM0P_TYPE1 EQU 34
CYDEV_CHIP_MEMBER_PDL_FM0P_TYPE2 EQU 35
CYDEV_CHIP_MEMBER_PDL_FM0P_TYPE3 EQU 36
CYDEV_CHIP_MEMBER_UNKNOWN EQU 0
CYDEV_CHIP_MEMBER_USED EQU CYDEV_CHIP_MEMBER_5B
CYDEV_CHIP_DIE_EXPECT EQU CYDEV_CHIP_MEMBER_USED
CYDEV_CHIP_DIE_ACTUAL EQU CYDEV_CHIP_DIE_EXPECT
CYDEV_CHIP_REV_LEOPARD_ES1 EQU 0
CYDEV_CHIP_REV_LEOPARD_ES2 EQU 1
CYDEV_CHIP_REV_LEOPARD_ES3 EQU 3
CYDEV_CHIP_REV_LEOPARD_PRODUCTION EQU 3
CYDEV_CHIP_REV_PSOC4A_ES0 EQU 17
CYDEV_CHIP_REV_PSOC4A_PRODUCTION EQU 17
CYDEV_CHIP_REV_PSOC5LP_ES0 EQU 0
CYDEV_CHIP_REV_PSOC5LP_PRODUCTION EQU 0
CYDEV_CHIP_REV_PSOC5TM_ES0 EQU 0
CYDEV_CHIP_REV_PSOC5TM_ES1 EQU 1
CYDEV_CHIP_REV_PSOC5TM_PRODUCTION EQU 1
CYDEV_CHIP_REV_TMA4_ES EQU 17
CYDEV_CHIP_REV_TMA4_ES2 EQU 33
CYDEV_CHIP_REV_TMA4_PRODUCTION EQU 17
CYDEV_CHIP_REVISION_3A_ES1 EQU 0
CYDEV_CHIP_REVISION_3A_ES2 EQU 1
CYDEV_CHIP_REVISION_3A_ES3 EQU 3
CYDEV_CHIP_REVISION_3A_PRODUCTION EQU 3
CYDEV_CHIP_REVISION_4A_ES0 EQU 17
CYDEV_CHIP_REVISION_4A_PRODUCTION EQU 17
CYDEV_CHIP_REVISION_4AA_PRODUCTION EQU 0
CYDEV_CHIP_REVISION_4AB_PRODUCTION EQU 0
CYDEV_CHIP_REVISION_4AC_PRODUCTION EQU 0
CYDEV_CHIP_REVISION_4AD_PRODUCTION EQU 0
CYDEV_CHIP_REVISION_4AE_PRODUCTION EQU 0
CYDEV_CHIP_REVISION_4D_PRODUCTION EQU 0
CYDEV_CHIP_REVISION_4E_CCG2_NO_USBPD EQU 0
CYDEV_CHIP_REVISION_4E_PRODUCTION EQU 0
CYDEV_CHIP_REVISION_4F_PRODUCTION EQU 0
CYDEV_CHIP_REVISION_4F_PRODUCTION_256DMA EQU 0
CYDEV_CHIP_REVISION_4F_PRODUCTION_256K EQU 0
CYDEV_CHIP_REVISION_4G_ES EQU 17
CYDEV_CHIP_REVISION_4G_ES2 EQU 33
CYDEV_CHIP_REVISION_4G_PRODUCTION EQU 17
CYDEV_CHIP_REVISION_4H_PRODUCTION EQU 0
CYDEV_CHIP_REVISION_4I_PRODUCTION EQU 0
CYDEV_CHIP_REVISION_4J_PRODUCTION EQU 0
CYDEV_CHIP_REVISION_4K_PRODUCTION EQU 0
CYDEV_CHIP_REVISION_4L_PRODUCTION EQU 0
CYDEV_CHIP_REVISION_4M_PRODUCTION EQU 0
CYDEV_CHIP_REVISION_4N_PRODUCTION EQU 0
CYDEV_CHIP_REVISION_4O_PRODUCTION EQU 0
CYDEV_CHIP_REVISION_4P_PRODUCTION EQU 0
CYDEV_CHIP_REVISION_4Q_PRODUCTION EQU 0
CYDEV_CHIP_REVISION_4R_PRODUCTION EQU 0
CYDEV_CHIP_REVISION_4S_PRODUCTION EQU 0
CYDEV_CHIP_REVISION_4T_PRODUCTION EQU 0
CYDEV_CHIP_REVISION_4U_PRODUCTION EQU 0
CYDEV_CHIP_REVISION_4V_PRODUCTION EQU 0
CYDEV_CHIP_REVISION_4W_PRODUCTION EQU 0
CYDEV_CHIP_REVISION_4X_PRODUCTION EQU 0
CYDEV_CHIP_REVISION_4Y_PRODUCTION EQU 0
CYDEV_CHIP_REVISION_4Z_PRODUCTION EQU 0
CYDEV_CHIP_REVISION_5A_ES0 EQU 0
CYDEV_CHIP_REVISION_5A_ES1 EQU 1
CYDEV_CHIP_REVISION_5A_PRODUCTION EQU 1
CYDEV_CHIP_REVISION_5B_ES0 EQU 0
CYDEV_CHIP_REVISION_5B_PRODUCTION EQU 0
CYDEV_CHIP_REVISION_6A_ES EQU 17
CYDEV_CHIP_REVISION_6A_NO_UDB EQU 33
CYDEV_CHIP_REVISION_6A_PRODUCTION EQU 33
CYDEV_CHIP_REVISION_FM3_PRODUCTION EQU 0
CYDEV_CHIP_REVISION_FM4_PRODUCTION EQU 0
CYDEV_CHIP_REVISION_PDL_FM0P_TYPE1_PRODUCTION EQU 0
CYDEV_CHIP_REVISION_PDL_FM0P_TYPE2_PRODUCTION EQU 0
CYDEV_CHIP_REVISION_PDL_FM0P_TYPE3_PRODUCTION EQU 0
CYDEV_CHIP_REVISION_USED EQU CYDEV_CHIP_REVISION_5B_PRODUCTION
CYDEV_CHIP_REV_EXPECT EQU CYDEV_CHIP_REVISION_USED
CYDEV_CONFIG_FASTBOOT_ENABLED EQU 1
CYDEV_CONFIG_UNUSED_IO_AllowButWarn EQU 0
CYDEV_CONFIG_UNUSED_IO EQU CYDEV_CONFIG_UNUSED_IO_AllowButWarn
CYDEV_CONFIG_UNUSED_IO_AllowWithInfo EQU 1
CYDEV_CONFIG_UNUSED_IO_Disallowed EQU 2
CYDEV_CONFIGURATION_COMPRESSED EQU 1
CYDEV_CONFIGURATION_DMA EQU 0
CYDEV_CONFIGURATION_ECC EQU 1
CYDEV_CONFIGURATION_IMOENABLED EQU CYDEV_CONFIG_FASTBOOT_ENABLED
CYDEV_CONFIGURATION_MODE_COMPRESSED EQU 0
CYDEV_CONFIGURATION_MODE EQU CYDEV_CONFIGURATION_MODE_COMPRESSED
CYDEV_CONFIGURATION_MODE_DMA EQU 2
CYDEV_CONFIGURATION_MODE_UNCOMPRESSED EQU 1
CYDEV_DEBUG_ENABLE_MASK EQU 0x20
CYDEV_DEBUG_ENABLE_REGISTER EQU CYREG_MLOGIC_DEBUG
CYDEV_DEBUGGING_DPS_Disable EQU 3
CYDEV_DEBUGGING_DPS_JTAG_4 EQU 1
CYDEV_DEBUGGING_DPS_JTAG_5 EQU 0
CYDEV_DEBUGGING_DPS_SWD EQU 2
CYDEV_DEBUGGING_DPS_SWD_SWV EQU 6
CYDEV_DEBUGGING_DPS EQU CYDEV_DEBUGGING_DPS_SWD_SWV
CYDEV_DEBUGGING_ENABLE EQU 1
CYDEV_DEBUGGING_XRES EQU 0
CYDEV_DMA_CHANNELS_AVAILABLE EQU 24
CYDEV_ECC_ENABLE EQU 0
CYDEV_HEAP_SIZE EQU 0x80
CYDEV_INSTRUCT_CACHE_ENABLED EQU 1
CYDEV_INTR_RISING EQU 0x00000000
CYDEV_IS_EXPORTING_CODE EQU 0
CYDEV_IS_IMPORTING_CODE EQU 0
CYDEV_PROJ_TYPE EQU 0
CYDEV_PROJ_TYPE_BOOTLOADER EQU 1
CYDEV_PROJ_TYPE_LAUNCHER EQU 5
CYDEV_PROJ_TYPE_LOADABLE EQU 2
CYDEV_PROJ_TYPE_LOADABLEANDBOOTLOADER EQU 4
CYDEV_PROJ_TYPE_MULTIAPPBOOTLOADER EQU 3
CYDEV_PROJ_TYPE_STANDARD EQU 0
CYDEV_PROTECTION_ENABLE EQU 0
CYDEV_STACK_SIZE EQU 0x0800
CYDEV_USE_BUNDLED_CMSIS EQU 1
CYDEV_VARIABLE_VDDA EQU 0
CYDEV_VDDA_MV EQU 5000
CYDEV_VDDD_MV EQU 5000
CYDEV_VDDIO0_MV EQU 5000
CYDEV_VDDIO1_MV EQU 5000
CYDEV_VDDIO2_MV EQU 5000
CYDEV_VDDIO3_MV EQU 5000
CYDEV_VIO0_MV EQU 5000
CYDEV_VIO1_MV EQU 5000
CYDEV_VIO2_MV EQU 5000
CYDEV_VIO3_MV EQU 5000
CYIPBLOCK_ARM_CM3_VERSION EQU 0
CYIPBLOCK_P3_ANAIF_VERSION EQU 0
CYIPBLOCK_P3_CAN_VERSION EQU 0
CYIPBLOCK_P3_CAPSENSE_VERSION EQU 0
CYIPBLOCK_P3_COMP_VERSION EQU 0
CYIPBLOCK_P3_DECIMATOR_VERSION EQU 0
CYIPBLOCK_P3_DFB_VERSION EQU 0
CYIPBLOCK_P3_DMA_VERSION EQU 0
CYIPBLOCK_P3_DRQ_VERSION EQU 0
CYIPBLOCK_P3_DSM_VERSION EQU 0
CYIPBLOCK_P3_EMIF_VERSION EQU 0
CYIPBLOCK_P3_I2C_VERSION EQU 0
CYIPBLOCK_P3_LCD_VERSION EQU 0
CYIPBLOCK_P3_LPF_VERSION EQU 0
CYIPBLOCK_P3_OPAMP_VERSION EQU 0
CYIPBLOCK_P3_PM_VERSION EQU 0
CYIPBLOCK_P3_SCCT_VERSION EQU 0
CYIPBLOCK_P3_TIMER_VERSION EQU 0
CYIPBLOCK_P3_USB_VERSION EQU 0
CYIPBLOCK_P3_VIDAC_VERSION EQU 0
CYIPBLOCK_P3_VREF_VERSION EQU 0
CYIPBLOCK_S8_GPIO_VERSION EQU 0
CYIPBLOCK_S8_IRQ_VERSION EQU 0
CYIPBLOCK_S8_SAR_VERSION EQU 0
CYIPBLOCK_S8_SIO_VERSION EQU 0
CYIPBLOCK_S8_UDB_VERSION EQU 0
DMA_CHANNELS_USED__MASK0 EQU 0x00000000
CYDEV_BOOTLOADER_ENABLE EQU 0

#endif /* INCLUDED_CYFITTERIAR_INC */
