;
; File Name: cyfitteriar.inc
; 
; PSoC Creator  4.4
;
; Description:
; 
;
;-------------------------------------------------------------------------------
; Copyright (c) 2007-2020 Cypress Semiconductor.  All rights reserved.
; You may use this file only in accordance with the license, terms, conditions, 
; disclaimers, and limitations in the end user license agreement accompanying 
; the software package with which this file was provided.
;-------------------------------------------------------------------------------

#ifndef INCLUDED_CYFITTERIAR_INC
#define INCLUDED_CYFITTERIAR_INC
    INCLUDE cydeviceiar.inc
    INCLUDE cydeviceiar_trm.inc

/* Clk */
Clk__0__INTTYPE EQU CYREG_PICU3_INTTYPE1
Clk__0__MASK EQU 0x02
Clk__0__PC EQU CYREG_PRT3_PC1
Clk__0__PORT EQU 3
Clk__0__SHIFT EQU 1
Clk__AG EQU CYREG_PRT3_AG
Clk__AMUX EQU CYREG_PRT3_AMUX
Clk__BIE EQU CYREG_PRT3_BIE
Clk__BIT_MASK EQU CYREG_PRT3_BIT_MASK
Clk__BYP EQU CYREG_PRT3_BYP
Clk__CTL EQU CYREG_PRT3_CTL
Clk__DM0 EQU CYREG_PRT3_DM0
Clk__DM1 EQU CYREG_PRT3_DM1
Clk__DM2 EQU CYREG_PRT3_DM2
Clk__DR EQU CYREG_PRT3_DR
Clk__INP_DIS EQU CYREG_PRT3_INP_DIS
Clk__INTTYPE_BASE EQU CYDEV_PICU_INTTYPE_PICU3_BASE
Clk__LCD_COM_SEG EQU CYREG_PRT3_LCD_COM_SEG
Clk__LCD_EN EQU CYREG_PRT3_LCD_EN
Clk__MASK EQU 0x02
Clk__PORT EQU 3
Clk__PRT EQU CYREG_PRT3_PRT
Clk__PRTDSI__CAPS_SEL EQU CYREG_PRT3_CAPS_SEL
Clk__PRTDSI__DBL_SYNC_IN EQU CYREG_PRT3_DBL_SYNC_IN
Clk__PRTDSI__OE_SEL0 EQU CYREG_PRT3_OE_SEL0
Clk__PRTDSI__OE_SEL1 EQU CYREG_PRT3_OE_SEL1
Clk__PRTDSI__OUT_SEL0 EQU CYREG_PRT3_OUT_SEL0
Clk__PRTDSI__OUT_SEL1 EQU CYREG_PRT3_OUT_SEL1
Clk__PRTDSI__SYNC_OUT EQU CYREG_PRT3_SYNC_OUT
Clk__PS EQU CYREG_PRT3_PS
Clk__SHIFT EQU 1
Clk__SLW EQU CYREG_PRT3_SLW

/* Rx_1 */
Rx_1__0__INTTYPE EQU CYREG_PICU12_INTTYPE6
Rx_1__0__MASK EQU 0x40
Rx_1__0__PC EQU CYREG_PRT12_PC6
Rx_1__0__PORT EQU 12
Rx_1__0__SHIFT EQU 6
Rx_1__AG EQU CYREG_PRT12_AG
Rx_1__BIE EQU CYREG_PRT12_BIE
Rx_1__BIT_MASK EQU CYREG_PRT12_BIT_MASK
Rx_1__BYP EQU CYREG_PRT12_BYP
Rx_1__DM0 EQU CYREG_PRT12_DM0
Rx_1__DM1 EQU CYREG_PRT12_DM1
Rx_1__DM2 EQU CYREG_PRT12_DM2
Rx_1__DR EQU CYREG_PRT12_DR
Rx_1__INP_DIS EQU CYREG_PRT12_INP_DIS
Rx_1__INTTYPE_BASE EQU CYDEV_PICU_INTTYPE_PICU12_BASE
Rx_1__MASK EQU 0x40
Rx_1__PORT EQU 12
Rx_1__PRT EQU CYREG_PRT12_PRT
Rx_1__PRTDSI__DBL_SYNC_IN EQU CYREG_PRT12_DBL_SYNC_IN
Rx_1__PRTDSI__OE_SEL0 EQU CYREG_PRT12_OE_SEL0
Rx_1__PRTDSI__OE_SEL1 EQU CYREG_PRT12_OE_SEL1
Rx_1__PRTDSI__OUT_SEL0 EQU CYREG_PRT12_OUT_SEL0
Rx_1__PRTDSI__OUT_SEL1 EQU CYREG_PRT12_OUT_SEL1
Rx_1__PRTDSI__SYNC_OUT EQU CYREG_PRT12_SYNC_OUT
Rx_1__PS EQU CYREG_PRT12_PS
Rx_1__SHIFT EQU 6
Rx_1__SIO_CFG EQU CYREG_PRT12_SIO_CFG
Rx_1__SIO_DIFF EQU CYREG_PRT12_SIO_DIFF
Rx_1__SIO_HYST_EN EQU CYREG_PRT12_SIO_HYST_EN
Rx_1__SIO_REG_HIFREQ EQU CYREG_PRT12_SIO_REG_HIFREQ
Rx_1__SLW EQU CYREG_PRT12_SLW

/* Tx_1 */
Tx_1__0__INTTYPE EQU CYREG_PICU12_INTTYPE7
Tx_1__0__MASK EQU 0x80
Tx_1__0__PC EQU CYREG_PRT12_PC7
Tx_1__0__PORT EQU 12
Tx_1__0__SHIFT EQU 7
Tx_1__AG EQU CYREG_PRT12_AG
Tx_1__BIE EQU CYREG_PRT12_BIE
Tx_1__BIT_MASK EQU CYREG_PRT12_BIT_MASK
Tx_1__BYP EQU CYREG_PRT12_BYP
Tx_1__DM0 EQU CYREG_PRT12_DM0
Tx_1__DM1 EQU CYREG_PRT12_DM1
Tx_1__DM2 EQU CYREG_PRT12_DM2
Tx_1__DR EQU CYREG_PRT12_DR
Tx_1__INP_DIS EQU CYREG_PRT12_INP_DIS
Tx_1__INTTYPE_BASE EQU CYDEV_PICU_INTTYPE_PICU12_BASE
Tx_1__MASK EQU 0x80
Tx_1__PORT EQU 12
Tx_1__PRT EQU CYREG_PRT12_PRT
Tx_1__PRTDSI__DBL_SYNC_IN EQU CYREG_PRT12_DBL_SYNC_IN
Tx_1__PRTDSI__OE_SEL0 EQU CYREG_PRT12_OE_SEL0
Tx_1__PRTDSI__OE_SEL1 EQU CYREG_PRT12_OE_SEL1
Tx_1__PRTDSI__OUT_SEL0 EQU CYREG_PRT12_OUT_SEL0
Tx_1__PRTDSI__OUT_SEL1 EQU CYREG_PRT12_OUT_SEL1
Tx_1__PRTDSI__SYNC_OUT EQU CYREG_PRT12_SYNC_OUT
Tx_1__PS EQU CYREG_PRT12_PS
Tx_1__SHIFT EQU 7
Tx_1__SIO_CFG EQU CYREG_PRT12_SIO_CFG
Tx_1__SIO_DIFF EQU CYREG_PRT12_SIO_DIFF
Tx_1__SIO_HYST_EN EQU CYREG_PRT12_SIO_HYST_EN
Tx_1__SIO_REG_HIFREQ EQU CYREG_PRT12_SIO_REG_HIFREQ
Tx_1__SLW EQU CYREG_PRT12_SLW

/* UART */
UART_BUART_sRX_RxBitCounter__16BIT_CONTROL_AUX_CTL_REG EQU CYREG_B1_UDB09_10_ACTL
UART_BUART_sRX_RxBitCounter__16BIT_CONTROL_CONTROL_REG EQU CYREG_B1_UDB09_10_CTL
UART_BUART_sRX_RxBitCounter__16BIT_CONTROL_COUNT_REG EQU CYREG_B1_UDB09_10_CTL
UART_BUART_sRX_RxBitCounter__16BIT_COUNT_CONTROL_REG EQU CYREG_B1_UDB09_10_CTL
UART_BUART_sRX_RxBitCounter__16BIT_COUNT_COUNT_REG EQU CYREG_B1_UDB09_10_CTL
UART_BUART_sRX_RxBitCounter__16BIT_MASK_MASK_REG EQU CYREG_B1_UDB09_10_MSK
UART_BUART_sRX_RxBitCounter__16BIT_MASK_PERIOD_REG EQU CYREG_B1_UDB09_10_MSK
UART_BUART_sRX_RxBitCounter__16BIT_PERIOD_MASK_REG EQU CYREG_B1_UDB09_10_MSK
UART_BUART_sRX_RxBitCounter__16BIT_PERIOD_PERIOD_REG EQU CYREG_B1_UDB09_10_MSK
UART_BUART_sRX_RxBitCounter__CONTROL_AUX_CTL_REG EQU CYREG_B1_UDB09_ACTL
UART_BUART_sRX_RxBitCounter__CONTROL_REG EQU CYREG_B1_UDB09_CTL
UART_BUART_sRX_RxBitCounter__CONTROL_ST_REG EQU CYREG_B1_UDB09_ST_CTL
UART_BUART_sRX_RxBitCounter__COUNT_REG EQU CYREG_B1_UDB09_CTL
UART_BUART_sRX_RxBitCounter__COUNT_ST_REG EQU CYREG_B1_UDB09_ST_CTL
UART_BUART_sRX_RxBitCounter__MASK_CTL_AUX_CTL_REG EQU CYREG_B1_UDB09_MSK_ACTL
UART_BUART_sRX_RxBitCounter__PER_CTL_AUX_CTL_REG EQU CYREG_B1_UDB09_MSK_ACTL
UART_BUART_sRX_RxBitCounter__PERIOD_REG EQU CYREG_B1_UDB09_MSK
UART_BUART_sRX_RxBitCounter_ST__16BIT_STATUS_AUX_CTL_REG EQU CYREG_B1_UDB09_10_ACTL
UART_BUART_sRX_RxBitCounter_ST__16BIT_STATUS_REG EQU CYREG_B1_UDB09_10_ST
UART_BUART_sRX_RxBitCounter_ST__MASK_REG EQU CYREG_B1_UDB09_MSK
UART_BUART_sRX_RxBitCounter_ST__MASK_ST_AUX_CTL_REG EQU CYREG_B1_UDB09_MSK_ACTL
UART_BUART_sRX_RxBitCounter_ST__PER_ST_AUX_CTL_REG EQU CYREG_B1_UDB09_MSK_ACTL
UART_BUART_sRX_RxBitCounter_ST__STATUS_AUX_CTL_REG EQU CYREG_B1_UDB09_ACTL
UART_BUART_sRX_RxBitCounter_ST__STATUS_CNT_REG EQU CYREG_B1_UDB09_ST_CTL
UART_BUART_sRX_RxBitCounter_ST__STATUS_CONTROL_REG EQU CYREG_B1_UDB09_ST_CTL
UART_BUART_sRX_RxBitCounter_ST__STATUS_REG EQU CYREG_B1_UDB09_ST
UART_BUART_sRX_RxShifter_u0__16BIT_A0_REG EQU CYREG_B1_UDB10_11_A0
UART_BUART_sRX_RxShifter_u0__16BIT_A1_REG EQU CYREG_B1_UDB10_11_A1
UART_BUART_sRX_RxShifter_u0__16BIT_D0_REG EQU CYREG_B1_UDB10_11_D0
UART_BUART_sRX_RxShifter_u0__16BIT_D1_REG EQU CYREG_B1_UDB10_11_D1
UART_BUART_sRX_RxShifter_u0__16BIT_DP_AUX_CTL_REG EQU CYREG_B1_UDB10_11_ACTL
UART_BUART_sRX_RxShifter_u0__16BIT_F0_REG EQU CYREG_B1_UDB10_11_F0
UART_BUART_sRX_RxShifter_u0__16BIT_F1_REG EQU CYREG_B1_UDB10_11_F1
UART_BUART_sRX_RxShifter_u0__A0_A1_REG EQU CYREG_B1_UDB10_A0_A1
UART_BUART_sRX_RxShifter_u0__A0_REG EQU CYREG_B1_UDB10_A0
UART_BUART_sRX_RxShifter_u0__A1_REG EQU CYREG_B1_UDB10_A1
UART_BUART_sRX_RxShifter_u0__D0_D1_REG EQU CYREG_B1_UDB10_D0_D1
UART_BUART_sRX_RxShifter_u0__D0_REG EQU CYREG_B1_UDB10_D0
UART_BUART_sRX_RxShifter_u0__D1_REG EQU CYREG_B1_UDB10_D1
UART_BUART_sRX_RxShifter_u0__DP_AUX_CTL_REG EQU CYREG_B1_UDB10_ACTL
UART_BUART_sRX_RxShifter_u0__F0_F1_REG EQU CYREG_B1_UDB10_F0_F1
UART_BUART_sRX_RxShifter_u0__F0_REG EQU CYREG_B1_UDB10_F0
UART_BUART_sRX_RxShifter_u0__F1_REG EQU CYREG_B1_UDB10_F1
UART_BUART_sRX_RxSts__16BIT_STATUS_AUX_CTL_REG EQU CYREG_B0_UDB08_09_ACTL
UART_BUART_sRX_RxSts__16BIT_STATUS_REG EQU CYREG_B0_UDB08_09_ST
UART_BUART_sRX_RxSts__3__MASK EQU 0x08
UART_BUART_sRX_RxSts__3__POS EQU 3
UART_BUART_sRX_RxSts__4__MASK EQU 0x10
UART_BUART_sRX_RxSts__4__POS EQU 4
UART_BUART_sRX_RxSts__5__MASK EQU 0x20
UART_BUART_sRX_RxSts__5__POS EQU 5
UART_BUART_sRX_RxSts__MASK EQU 0x38
UART_BUART_sRX_RxSts__MASK_REG EQU CYREG_B0_UDB08_MSK
UART_BUART_sRX_RxSts__STATUS_AUX_CTL_REG EQU CYREG_B0_UDB08_ACTL
UART_BUART_sRX_RxSts__STATUS_REG EQU CYREG_B0_UDB08_ST
UART_BUART_sTX_sCLOCK_TxBitClkGen__16BIT_A0_REG EQU CYREG_B0_UDB08_09_A0
UART_BUART_sTX_sCLOCK_TxBitClkGen__16BIT_A1_REG EQU CYREG_B0_UDB08_09_A1
UART_BUART_sTX_sCLOCK_TxBitClkGen__16BIT_D0_REG EQU CYREG_B0_UDB08_09_D0
UART_BUART_sTX_sCLOCK_TxBitClkGen__16BIT_D1_REG EQU CYREG_B0_UDB08_09_D1
UART_BUART_sTX_sCLOCK_TxBitClkGen__16BIT_DP_AUX_CTL_REG EQU CYREG_B0_UDB08_09_ACTL
UART_BUART_sTX_sCLOCK_TxBitClkGen__16BIT_F0_REG EQU CYREG_B0_UDB08_09_F0
UART_BUART_sTX_sCLOCK_TxBitClkGen__16BIT_F1_REG EQU CYREG_B0_UDB08_09_F1
UART_BUART_sTX_sCLOCK_TxBitClkGen__A0_A1_REG EQU CYREG_B0_UDB08_A0_A1
UART_BUART_sTX_sCLOCK_TxBitClkGen__A0_REG EQU CYREG_B0_UDB08_A0
UART_BUART_sTX_sCLOCK_TxBitClkGen__A1_REG EQU CYREG_B0_UDB08_A1
UART_BUART_sTX_sCLOCK_TxBitClkGen__D0_D1_REG EQU CYREG_B0_UDB08_D0_D1
UART_BUART_sTX_sCLOCK_TxBitClkGen__D0_REG EQU CYREG_B0_UDB08_D0
UART_BUART_sTX_sCLOCK_TxBitClkGen__D1_REG EQU CYREG_B0_UDB08_D1
UART_BUART_sTX_sCLOCK_TxBitClkGen__DP_AUX_CTL_REG EQU CYREG_B0_UDB08_ACTL
UART_BUART_sTX_sCLOCK_TxBitClkGen__F0_F1_REG EQU CYREG_B0_UDB08_F0_F1
UART_BUART_sTX_sCLOCK_TxBitClkGen__F0_REG EQU CYREG_B0_UDB08_F0
UART_BUART_sTX_sCLOCK_TxBitClkGen__F1_REG EQU CYREG_B0_UDB08_F1
UART_BUART_sTX_TxShifter_u0__16BIT_A0_REG EQU CYREG_B1_UDB08_09_A0
UART_BUART_sTX_TxShifter_u0__16BIT_A1_REG EQU CYREG_B1_UDB08_09_A1
UART_BUART_sTX_TxShifter_u0__16BIT_D0_REG EQU CYREG_B1_UDB08_09_D0
UART_BUART_sTX_TxShifter_u0__16BIT_D1_REG EQU CYREG_B1_UDB08_09_D1
UART_BUART_sTX_TxShifter_u0__16BIT_DP_AUX_CTL_REG EQU CYREG_B1_UDB08_09_ACTL
UART_BUART_sTX_TxShifter_u0__16BIT_F0_REG EQU CYREG_B1_UDB08_09_F0
UART_BUART_sTX_TxShifter_u0__16BIT_F1_REG EQU CYREG_B1_UDB08_09_F1
UART_BUART_sTX_TxShifter_u0__A0_A1_REG EQU CYREG_B1_UDB08_A0_A1
UART_BUART_sTX_TxShifter_u0__A0_REG EQU CYREG_B1_UDB08_A0
UART_BUART_sTX_TxShifter_u0__A1_REG EQU CYREG_B1_UDB08_A1
UART_BUART_sTX_TxShifter_u0__D0_D1_REG EQU CYREG_B1_UDB08_D0_D1
UART_BUART_sTX_TxShifter_u0__D0_REG EQU CYREG_B1_UDB08_D0
UART_BUART_sTX_TxShifter_u0__D1_REG EQU CYREG_B1_UDB08_D1
UART_BUART_sTX_TxShifter_u0__DP_AUX_CTL_REG EQU CYREG_B1_UDB08_ACTL
UART_BUART_sTX_TxShifter_u0__F0_F1_REG EQU CYREG_B1_UDB08_F0_F1
UART_BUART_sTX_TxShifter_u0__F0_REG EQU CYREG_B1_UDB08_F0
UART_BUART_sTX_TxShifter_u0__F1_REG EQU CYREG_B1_UDB08_F1
UART_BUART_sTX_TxSts__0__MASK EQU 0x01
UART_BUART_sTX_TxSts__0__POS EQU 0
UART_BUART_sTX_TxSts__1__MASK EQU 0x02
UART_BUART_sTX_TxSts__1__POS EQU 1
UART_BUART_sTX_TxSts__2__MASK EQU 0x04
UART_BUART_sTX_TxSts__2__POS EQU 2
UART_BUART_sTX_TxSts__3__MASK EQU 0x08
UART_BUART_sTX_TxSts__3__POS EQU 3
UART_BUART_sTX_TxSts__MASK EQU 0x0F
UART_BUART_sTX_TxSts__MASK_REG EQU CYREG_B1_UDB11_MSK
UART_BUART_sTX_TxSts__MASK_ST_AUX_CTL_REG EQU CYREG_B1_UDB11_MSK_ACTL
UART_BUART_sTX_TxSts__PER_ST_AUX_CTL_REG EQU CYREG_B1_UDB11_MSK_ACTL
UART_BUART_sTX_TxSts__STATUS_AUX_CTL_REG EQU CYREG_B1_UDB11_ACTL
UART_BUART_sTX_TxSts__STATUS_CNT_REG EQU CYREG_B1_UDB11_ST_CTL
UART_BUART_sTX_TxSts__STATUS_CONTROL_REG EQU CYREG_B1_UDB11_ST_CTL
UART_BUART_sTX_TxSts__STATUS_REG EQU CYREG_B1_UDB11_ST
UART_IntClock__CFG0 EQU CYREG_CLKDIST_DCFG0_CFG0
UART_IntClock__CFG1 EQU CYREG_CLKDIST_DCFG0_CFG1
UART_IntClock__CFG2 EQU CYREG_CLKDIST_DCFG0_CFG2
UART_IntClock__CFG2_SRC_SEL_MASK EQU 0x07
UART_IntClock__INDEX EQU 0x00
UART_IntClock__PM_ACT_CFG EQU CYREG_PM_ACT_CFG2
UART_IntClock__PM_ACT_MSK EQU 0x01
UART_IntClock__PM_STBY_CFG EQU CYREG_PM_STBY_CFG2
UART_IntClock__PM_STBY_MSK EQU 0x01
UART_RXInternalInterrupt__INTC_CLR_EN_REG EQU CYREG_NVIC_CLRENA0
UART_RXInternalInterrupt__INTC_CLR_PD_REG EQU CYREG_NVIC_CLRPEND0
UART_RXInternalInterrupt__INTC_MASK EQU 0x01
UART_RXInternalInterrupt__INTC_NUMBER EQU 0
UART_RXInternalInterrupt__INTC_PRIOR_NUM EQU 7
UART_RXInternalInterrupt__INTC_PRIOR_REG EQU CYREG_NVIC_PRI_0
UART_RXInternalInterrupt__INTC_SET_EN_REG EQU CYREG_NVIC_SETENA0
UART_RXInternalInterrupt__INTC_SET_PD_REG EQU CYREG_NVIC_SETPEND0

/* isr_1 */
isr_1__INTC_CLR_EN_REG EQU CYREG_NVIC_CLRENA0
isr_1__INTC_CLR_PD_REG EQU CYREG_NVIC_CLRPEND0
isr_1__INTC_MASK EQU 0x02
isr_1__INTC_NUMBER EQU 1
isr_1__INTC_PRIOR_NUM EQU 6
isr_1__INTC_PRIOR_REG EQU CYREG_NVIC_PRI_1
isr_1__INTC_SET_EN_REG EQU CYREG_NVIC_SETENA0
isr_1__INTC_SET_PD_REG EQU CYREG_NVIC_SETPEND0

/* isr_2 */
isr_2__INTC_CLR_EN_REG EQU CYREG_NVIC_CLRENA0
isr_2__INTC_CLR_PD_REG EQU CYREG_NVIC_CLRPEND0
isr_2__INTC_MASK EQU 0x04
isr_2__INTC_NUMBER EQU 2
isr_2__INTC_PRIOR_NUM EQU 7
isr_2__INTC_PRIOR_REG EQU CYREG_NVIC_PRI_2
isr_2__INTC_SET_EN_REG EQU CYREG_NVIC_SETENA0
isr_2__INTC_SET_PD_REG EQU CYREG_NVIC_SETPEND0

/* Ctrl_M1 */
Ctrl_M1__0__INTTYPE EQU CYREG_PICU3_INTTYPE2
Ctrl_M1__0__MASK EQU 0x04
Ctrl_M1__0__PC EQU CYREG_PRT3_PC2
Ctrl_M1__0__PORT EQU 3
Ctrl_M1__0__SHIFT EQU 2
Ctrl_M1__AG EQU CYREG_PRT3_AG
Ctrl_M1__AMUX EQU CYREG_PRT3_AMUX
Ctrl_M1__BIE EQU CYREG_PRT3_BIE
Ctrl_M1__BIT_MASK EQU CYREG_PRT3_BIT_MASK
Ctrl_M1__BYP EQU CYREG_PRT3_BYP
Ctrl_M1__CTL EQU CYREG_PRT3_CTL
Ctrl_M1__DM0 EQU CYREG_PRT3_DM0
Ctrl_M1__DM1 EQU CYREG_PRT3_DM1
Ctrl_M1__DM2 EQU CYREG_PRT3_DM2
Ctrl_M1__DR EQU CYREG_PRT3_DR
Ctrl_M1__INP_DIS EQU CYREG_PRT3_INP_DIS
Ctrl_M1__INTTYPE_BASE EQU CYDEV_PICU_INTTYPE_PICU3_BASE
Ctrl_M1__LCD_COM_SEG EQU CYREG_PRT3_LCD_COM_SEG
Ctrl_M1__LCD_EN EQU CYREG_PRT3_LCD_EN
Ctrl_M1__MASK EQU 0x04
Ctrl_M1__PORT EQU 3
Ctrl_M1__PRT EQU CYREG_PRT3_PRT
Ctrl_M1__PRTDSI__CAPS_SEL EQU CYREG_PRT3_CAPS_SEL
Ctrl_M1__PRTDSI__DBL_SYNC_IN EQU CYREG_PRT3_DBL_SYNC_IN
Ctrl_M1__PRTDSI__OE_SEL0 EQU CYREG_PRT3_OE_SEL0
Ctrl_M1__PRTDSI__OE_SEL1 EQU CYREG_PRT3_OE_SEL1
Ctrl_M1__PRTDSI__OUT_SEL0 EQU CYREG_PRT3_OUT_SEL0
Ctrl_M1__PRTDSI__OUT_SEL1 EQU CYREG_PRT3_OUT_SEL1
Ctrl_M1__PRTDSI__SYNC_OUT EQU CYREG_PRT3_SYNC_OUT
Ctrl_M1__PS EQU CYREG_PRT3_PS
Ctrl_M1__SHIFT EQU 2
Ctrl_M1__SLW EQU CYREG_PRT3_SLW

/* Ctrl_RD */
Ctrl_RD__0__INTTYPE EQU CYREG_PICU3_INTTYPE4
Ctrl_RD__0__MASK EQU 0x10
Ctrl_RD__0__PC EQU CYREG_PRT3_PC4
Ctrl_RD__0__PORT EQU 3
Ctrl_RD__0__SHIFT EQU 4
Ctrl_RD__AG EQU CYREG_PRT3_AG
Ctrl_RD__AMUX EQU CYREG_PRT3_AMUX
Ctrl_RD__BIE EQU CYREG_PRT3_BIE
Ctrl_RD__BIT_MASK EQU CYREG_PRT3_BIT_MASK
Ctrl_RD__BYP EQU CYREG_PRT3_BYP
Ctrl_RD__CTL EQU CYREG_PRT3_CTL
Ctrl_RD__DM0 EQU CYREG_PRT3_DM0
Ctrl_RD__DM1 EQU CYREG_PRT3_DM1
Ctrl_RD__DM2 EQU CYREG_PRT3_DM2
Ctrl_RD__DR EQU CYREG_PRT3_DR
Ctrl_RD__INP_DIS EQU CYREG_PRT3_INP_DIS
Ctrl_RD__INTTYPE_BASE EQU CYDEV_PICU_INTTYPE_PICU3_BASE
Ctrl_RD__LCD_COM_SEG EQU CYREG_PRT3_LCD_COM_SEG
Ctrl_RD__LCD_EN EQU CYREG_PRT3_LCD_EN
Ctrl_RD__MASK EQU 0x10
Ctrl_RD__PORT EQU 3
Ctrl_RD__PRT EQU CYREG_PRT3_PRT
Ctrl_RD__PRTDSI__CAPS_SEL EQU CYREG_PRT3_CAPS_SEL
Ctrl_RD__PRTDSI__DBL_SYNC_IN EQU CYREG_PRT3_DBL_SYNC_IN
Ctrl_RD__PRTDSI__OE_SEL0 EQU CYREG_PRT3_OE_SEL0
Ctrl_RD__PRTDSI__OE_SEL1 EQU CYREG_PRT3_OE_SEL1
Ctrl_RD__PRTDSI__OUT_SEL0 EQU CYREG_PRT3_OUT_SEL0
Ctrl_RD__PRTDSI__OUT_SEL1 EQU CYREG_PRT3_OUT_SEL1
Ctrl_RD__PRTDSI__SYNC_OUT EQU CYREG_PRT3_SYNC_OUT
Ctrl_RD__PS EQU CYREG_PRT3_PS
Ctrl_RD__SHIFT EQU 4
Ctrl_RD__SLW EQU CYREG_PRT3_SLW

/* Ctrl_WR */
Ctrl_WR__0__INTTYPE EQU CYREG_PICU3_INTTYPE5
Ctrl_WR__0__MASK EQU 0x20
Ctrl_WR__0__PC EQU CYREG_PRT3_PC5
Ctrl_WR__0__PORT EQU 3
Ctrl_WR__0__SHIFT EQU 5
Ctrl_WR__AG EQU CYREG_PRT3_AG
Ctrl_WR__AMUX EQU CYREG_PRT3_AMUX
Ctrl_WR__BIE EQU CYREG_PRT3_BIE
Ctrl_WR__BIT_MASK EQU CYREG_PRT3_BIT_MASK
Ctrl_WR__BYP EQU CYREG_PRT3_BYP
Ctrl_WR__CTL EQU CYREG_PRT3_CTL
Ctrl_WR__DM0 EQU CYREG_PRT3_DM0
Ctrl_WR__DM1 EQU CYREG_PRT3_DM1
Ctrl_WR__DM2 EQU CYREG_PRT3_DM2
Ctrl_WR__DR EQU CYREG_PRT3_DR
Ctrl_WR__INP_DIS EQU CYREG_PRT3_INP_DIS
Ctrl_WR__INTTYPE_BASE EQU CYDEV_PICU_INTTYPE_PICU3_BASE
Ctrl_WR__LCD_COM_SEG EQU CYREG_PRT3_LCD_COM_SEG
Ctrl_WR__LCD_EN EQU CYREG_PRT3_LCD_EN
Ctrl_WR__MASK EQU 0x20
Ctrl_WR__PORT EQU 3
Ctrl_WR__PRT EQU CYREG_PRT3_PRT
Ctrl_WR__PRTDSI__CAPS_SEL EQU CYREG_PRT3_CAPS_SEL
Ctrl_WR__PRTDSI__DBL_SYNC_IN EQU CYREG_PRT3_DBL_SYNC_IN
Ctrl_WR__PRTDSI__OE_SEL0 EQU CYREG_PRT3_OE_SEL0
Ctrl_WR__PRTDSI__OE_SEL1 EQU CYREG_PRT3_OE_SEL1
Ctrl_WR__PRTDSI__OUT_SEL0 EQU CYREG_PRT3_OUT_SEL0
Ctrl_WR__PRTDSI__OUT_SEL1 EQU CYREG_PRT3_OUT_SEL1
Ctrl_WR__PRTDSI__SYNC_OUT EQU CYREG_PRT3_SYNC_OUT
Ctrl_WR__PS EQU CYREG_PRT3_PS
Ctrl_WR__SHIFT EQU 5
Ctrl_WR__SLW EQU CYREG_PRT3_SLW

/* Ctrl_MREQ */
Ctrl_MREQ__0__INTTYPE EQU CYREG_PICU3_INTTYPE3
Ctrl_MREQ__0__MASK EQU 0x08
Ctrl_MREQ__0__PC EQU CYREG_PRT3_PC3
Ctrl_MREQ__0__PORT EQU 3
Ctrl_MREQ__0__SHIFT EQU 3
Ctrl_MREQ__AG EQU CYREG_PRT3_AG
Ctrl_MREQ__AMUX EQU CYREG_PRT3_AMUX
Ctrl_MREQ__BIE EQU CYREG_PRT3_BIE
Ctrl_MREQ__BIT_MASK EQU CYREG_PRT3_BIT_MASK
Ctrl_MREQ__BYP EQU CYREG_PRT3_BYP
Ctrl_MREQ__CTL EQU CYREG_PRT3_CTL
Ctrl_MREQ__DM0 EQU CYREG_PRT3_DM0
Ctrl_MREQ__DM1 EQU CYREG_PRT3_DM1
Ctrl_MREQ__DM2 EQU CYREG_PRT3_DM2
Ctrl_MREQ__DR EQU CYREG_PRT3_DR
Ctrl_MREQ__INP_DIS EQU CYREG_PRT3_INP_DIS
Ctrl_MREQ__INTTYPE_BASE EQU CYDEV_PICU_INTTYPE_PICU3_BASE
Ctrl_MREQ__LCD_COM_SEG EQU CYREG_PRT3_LCD_COM_SEG
Ctrl_MREQ__LCD_EN EQU CYREG_PRT3_LCD_EN
Ctrl_MREQ__MASK EQU 0x08
Ctrl_MREQ__PORT EQU 3
Ctrl_MREQ__PRT EQU CYREG_PRT3_PRT
Ctrl_MREQ__PRTDSI__CAPS_SEL EQU CYREG_PRT3_CAPS_SEL
Ctrl_MREQ__PRTDSI__DBL_SYNC_IN EQU CYREG_PRT3_DBL_SYNC_IN
Ctrl_MREQ__PRTDSI__OE_SEL0 EQU CYREG_PRT3_OE_SEL0
Ctrl_MREQ__PRTDSI__OE_SEL1 EQU CYREG_PRT3_OE_SEL1
Ctrl_MREQ__PRTDSI__OUT_SEL0 EQU CYREG_PRT3_OUT_SEL0
Ctrl_MREQ__PRTDSI__OUT_SEL1 EQU CYREG_PRT3_OUT_SEL1
Ctrl_MREQ__PRTDSI__SYNC_OUT EQU CYREG_PRT3_SYNC_OUT
Ctrl_MREQ__PS EQU CYREG_PRT3_PS
Ctrl_MREQ__SHIFT EQU 3
Ctrl_MREQ__SLW EQU CYREG_PRT3_SLW

/* Z80_Clock */
Z80_Clock__CFG0 EQU CYREG_CLKDIST_DCFG1_CFG0
Z80_Clock__CFG1 EQU CYREG_CLKDIST_DCFG1_CFG1
Z80_Clock__CFG2 EQU CYREG_CLKDIST_DCFG1_CFG2
Z80_Clock__CFG2_SRC_SEL_MASK EQU 0x07
Z80_Clock__INDEX EQU 0x01
Z80_Clock__PM_ACT_CFG EQU CYREG_PM_ACT_CFG2
Z80_Clock__PM_ACT_MSK EQU 0x02
Z80_Clock__PM_STBY_CFG EQU CYREG_PM_STBY_CFG2
Z80_Clock__PM_STBY_MSK EQU 0x02

/* Clock_Ctrl */
Clock_Ctrl_Sync_ctrl_reg__0__MASK EQU 0x01
Clock_Ctrl_Sync_ctrl_reg__0__POS EQU 0
Clock_Ctrl_Sync_ctrl_reg__1__MASK EQU 0x02
Clock_Ctrl_Sync_ctrl_reg__1__POS EQU 1
Clock_Ctrl_Sync_ctrl_reg__CONTROL_AUX_CTL_REG EQU CYREG_B1_UDB11_ACTL
Clock_Ctrl_Sync_ctrl_reg__CONTROL_REG EQU CYREG_B1_UDB11_CTL
Clock_Ctrl_Sync_ctrl_reg__CONTROL_ST_REG EQU CYREG_B1_UDB11_ST_CTL
Clock_Ctrl_Sync_ctrl_reg__COUNT_REG EQU CYREG_B1_UDB11_CTL
Clock_Ctrl_Sync_ctrl_reg__COUNT_ST_REG EQU CYREG_B1_UDB11_ST_CTL
Clock_Ctrl_Sync_ctrl_reg__MASK EQU 0x03
Clock_Ctrl_Sync_ctrl_reg__MASK_CTL_AUX_CTL_REG EQU CYREG_B1_UDB11_MSK_ACTL
Clock_Ctrl_Sync_ctrl_reg__PER_CTL_AUX_CTL_REG EQU CYREG_B1_UDB11_MSK_ACTL
Clock_Ctrl_Sync_ctrl_reg__PERIOD_REG EQU CYREG_B1_UDB11_MSK

/* Ctrl_Reset */
Ctrl_Reset__0__INTTYPE EQU CYREG_PICU3_INTTYPE0
Ctrl_Reset__0__MASK EQU 0x01
Ctrl_Reset__0__PC EQU CYREG_PRT3_PC0
Ctrl_Reset__0__PORT EQU 3
Ctrl_Reset__0__SHIFT EQU 0
Ctrl_Reset__AG EQU CYREG_PRT3_AG
Ctrl_Reset__AMUX EQU CYREG_PRT3_AMUX
Ctrl_Reset__BIE EQU CYREG_PRT3_BIE
Ctrl_Reset__BIT_MASK EQU CYREG_PRT3_BIT_MASK
Ctrl_Reset__BYP EQU CYREG_PRT3_BYP
Ctrl_Reset__CTL EQU CYREG_PRT3_CTL
Ctrl_Reset__DM0 EQU CYREG_PRT3_DM0
Ctrl_Reset__DM1 EQU CYREG_PRT3_DM1
Ctrl_Reset__DM2 EQU CYREG_PRT3_DM2
Ctrl_Reset__DR EQU CYREG_PRT3_DR
Ctrl_Reset__INP_DIS EQU CYREG_PRT3_INP_DIS
Ctrl_Reset__INTTYPE_BASE EQU CYDEV_PICU_INTTYPE_PICU3_BASE
Ctrl_Reset__LCD_COM_SEG EQU CYREG_PRT3_LCD_COM_SEG
Ctrl_Reset__LCD_EN EQU CYREG_PRT3_LCD_EN
Ctrl_Reset__MASK EQU 0x01
Ctrl_Reset__PORT EQU 3
Ctrl_Reset__PRT EQU CYREG_PRT3_PRT
Ctrl_Reset__PRTDSI__CAPS_SEL EQU CYREG_PRT3_CAPS_SEL
Ctrl_Reset__PRTDSI__DBL_SYNC_IN EQU CYREG_PRT3_DBL_SYNC_IN
Ctrl_Reset__PRTDSI__OE_SEL0 EQU CYREG_PRT3_OE_SEL0
Ctrl_Reset__PRTDSI__OE_SEL1 EQU CYREG_PRT3_OE_SEL1
Ctrl_Reset__PRTDSI__OUT_SEL0 EQU CYREG_PRT3_OUT_SEL0
Ctrl_Reset__PRTDSI__OUT_SEL1 EQU CYREG_PRT3_OUT_SEL1
Ctrl_Reset__PRTDSI__SYNC_OUT EQU CYREG_PRT3_SYNC_OUT
Ctrl_Reset__PS EQU CYREG_PRT3_PS
Ctrl_Reset__SHIFT EQU 0
Ctrl_Reset__SLW EQU CYREG_PRT3_SLW

/* User_Button */
User_Button__0__INTTYPE EQU CYREG_PICU1_INTTYPE2
User_Button__0__MASK EQU 0x04
User_Button__0__PC EQU CYREG_PRT1_PC2
User_Button__0__PORT EQU 1
User_Button__0__SHIFT EQU 2
User_Button__AG EQU CYREG_PRT1_AG
User_Button__AMUX EQU CYREG_PRT1_AMUX
User_Button__BIE EQU CYREG_PRT1_BIE
User_Button__BIT_MASK EQU CYREG_PRT1_BIT_MASK
User_Button__BYP EQU CYREG_PRT1_BYP
User_Button__CTL EQU CYREG_PRT1_CTL
User_Button__DM0 EQU CYREG_PRT1_DM0
User_Button__DM1 EQU CYREG_PRT1_DM1
User_Button__DM2 EQU CYREG_PRT1_DM2
User_Button__DR EQU CYREG_PRT1_DR
User_Button__INP_DIS EQU CYREG_PRT1_INP_DIS
User_Button__INTTYPE_BASE EQU CYDEV_PICU_INTTYPE_PICU1_BASE
User_Button__LCD_COM_SEG EQU CYREG_PRT1_LCD_COM_SEG
User_Button__LCD_EN EQU CYREG_PRT1_LCD_EN
User_Button__MASK EQU 0x04
User_Button__PORT EQU 1
User_Button__PRT EQU CYREG_PRT1_PRT
User_Button__PRTDSI__CAPS_SEL EQU CYREG_PRT1_CAPS_SEL
User_Button__PRTDSI__DBL_SYNC_IN EQU CYREG_PRT1_DBL_SYNC_IN
User_Button__PRTDSI__OE_SEL0 EQU CYREG_PRT1_OE_SEL0
User_Button__PRTDSI__OE_SEL1 EQU CYREG_PRT1_OE_SEL1
User_Button__PRTDSI__OUT_SEL0 EQU CYREG_PRT1_OUT_SEL0
User_Button__PRTDSI__OUT_SEL1 EQU CYREG_PRT1_OUT_SEL1
User_Button__PRTDSI__SYNC_OUT EQU CYREG_PRT1_SYNC_OUT
User_Button__PS EQU CYREG_PRT1_PS
User_Button__SHIFT EQU 2
User_Button__SLW EQU CYREG_PRT1_SLW

/* Miscellaneous */
BCLK__BUS_CLK__HZ EQU 24000000
BCLK__BUS_CLK__KHZ EQU 24000
BCLK__BUS_CLK__MHZ EQU 24
CYDEV_CHIP_DIE_LEOPARD EQU 1
CYDEV_CHIP_DIE_PSOC4A EQU 26
CYDEV_CHIP_DIE_PSOC5LP EQU 2
CYDEV_CHIP_DIE_PSOC5TM EQU 3
CYDEV_CHIP_DIE_TMA4 EQU 4
CYDEV_CHIP_DIE_UNKNOWN EQU 0
CYDEV_CHIP_FAMILY_FM0P EQU 5
CYDEV_CHIP_FAMILY_FM3 EQU 6
CYDEV_CHIP_FAMILY_FM4 EQU 7
CYDEV_CHIP_FAMILY_PSOC3 EQU 1
CYDEV_CHIP_FAMILY_PSOC4 EQU 2
CYDEV_CHIP_FAMILY_PSOC5 EQU 3
CYDEV_CHIP_FAMILY_PSOC6 EQU 4
CYDEV_CHIP_FAMILY_UNKNOWN EQU 0
CYDEV_CHIP_FAMILY_USED EQU CYDEV_CHIP_FAMILY_PSOC5
CYDEV_CHIP_JTAG_ID EQU 0x2E161069
CYDEV_CHIP_MEMBER_3A EQU 1
CYDEV_CHIP_MEMBER_4A EQU 26
CYDEV_CHIP_MEMBER_4AA EQU 25
CYDEV_CHIP_MEMBER_4AB EQU 30
CYDEV_CHIP_MEMBER_4AC EQU 14
CYDEV_CHIP_MEMBER_4AD EQU 15
CYDEV_CHIP_MEMBER_4AE EQU 16
CYDEV_CHIP_MEMBER_4D EQU 20
CYDEV_CHIP_MEMBER_4E EQU 6
CYDEV_CHIP_MEMBER_4F EQU 27
CYDEV_CHIP_MEMBER_4G EQU 4
CYDEV_CHIP_MEMBER_4H EQU 24
CYDEV_CHIP_MEMBER_4I EQU 32
CYDEV_CHIP_MEMBER_4J EQU 21
CYDEV_CHIP_MEMBER_4K EQU 22
CYDEV_CHIP_MEMBER_4L EQU 31
CYDEV_CHIP_MEMBER_4M EQU 29
CYDEV_CHIP_MEMBER_4N EQU 11
CYDEV_CHIP_MEMBER_4O EQU 8
CYDEV_CHIP_MEMBER_4P EQU 28
CYDEV_CHIP_MEMBER_4Q EQU 17
CYDEV_CHIP_MEMBER_4R EQU 9
CYDEV_CHIP_MEMBER_4S EQU 12
CYDEV_CHIP_MEMBER_4T EQU 10
CYDEV_CHIP_MEMBER_4U EQU 5
CYDEV_CHIP_MEMBER_4V EQU 23
CYDEV_CHIP_MEMBER_4W EQU 13
CYDEV_CHIP_MEMBER_4X EQU 7
CYDEV_CHIP_MEMBER_4Y EQU 18
CYDEV_CHIP_MEMBER_4Z EQU 19
CYDEV_CHIP_MEMBER_5A EQU 3
CYDEV_CHIP_MEMBER_5B EQU 2
CYDEV_CHIP_MEMBER_6A EQU 33
CYDEV_CHIP_MEMBER_FM3 EQU 37
CYDEV_CHIP_MEMBER_FM4 EQU 38
CYDEV_CHIP_MEMBER_PDL_FM0P_TYPE1 EQU 34
CYDEV_CHIP_MEMBER_PDL_FM0P_TYPE2 EQU 35
CYDEV_CHIP_MEMBER_PDL_FM0P_TYPE3 EQU 36
CYDEV_CHIP_MEMBER_UNKNOWN EQU 0
CYDEV_CHIP_MEMBER_USED EQU CYDEV_CHIP_MEMBER_5B
CYDEV_CHIP_DIE_EXPECT EQU CYDEV_CHIP_MEMBER_USED
CYDEV_CHIP_DIE_ACTUAL EQU CYDEV_CHIP_DIE_EXPECT
CYDEV_CHIP_REV_LEOPARD_ES1 EQU 0
CYDEV_CHIP_REV_LEOPARD_ES2 EQU 1
CYDEV_CHIP_REV_LEOPARD_ES3 EQU 3
CYDEV_CHIP_REV_LEOPARD_PRODUCTION EQU 3
CYDEV_CHIP_REV_PSOC4A_ES0 EQU 17
CYDEV_CHIP_REV_PSOC4A_PRODUCTION EQU 17
CYDEV_CHIP_REV_PSOC5LP_ES0 EQU 0
CYDEV_CHIP_REV_PSOC5LP_PRODUCTION EQU 0
CYDEV_CHIP_REV_PSOC5TM_ES0 EQU 0
CYDEV_CHIP_REV_PSOC5TM_ES1 EQU 1
CYDEV_CHIP_REV_PSOC5TM_PRODUCTION EQU 1
CYDEV_CHIP_REV_TMA4_ES EQU 17
CYDEV_CHIP_REV_TMA4_ES2 EQU 33
CYDEV_CHIP_REV_TMA4_PRODUCTION EQU 17
CYDEV_CHIP_REVISION_3A_ES1 EQU 0
CYDEV_CHIP_REVISION_3A_ES2 EQU 1
CYDEV_CHIP_REVISION_3A_ES3 EQU 3
CYDEV_CHIP_REVISION_3A_PRODUCTION EQU 3
CYDEV_CHIP_REVISION_4A_ES0 EQU 17
CYDEV_CHIP_REVISION_4A_PRODUCTION EQU 17
CYDEV_CHIP_REVISION_4AA_PRODUCTION EQU 0
CYDEV_CHIP_REVISION_4AB_PRODUCTION EQU 0
CYDEV_CHIP_REVISION_4AC_PRODUCTION EQU 0
CYDEV_CHIP_REVISION_4AD_PRODUCTION EQU 0
CYDEV_CHIP_REVISION_4AE_PRODUCTION EQU 0
CYDEV_CHIP_REVISION_4D_PRODUCTION EQU 0
CYDEV_CHIP_REVISION_4E_CCG2_NO_USBPD EQU 0
CYDEV_CHIP_REVISION_4E_PRODUCTION EQU 0
CYDEV_CHIP_REVISION_4F_PRODUCTION EQU 0
CYDEV_CHIP_REVISION_4F_PRODUCTION_256DMA EQU 0
CYDEV_CHIP_REVISION_4F_PRODUCTION_256K EQU 0
CYDEV_CHIP_REVISION_4G_ES EQU 17
CYDEV_CHIP_REVISION_4G_ES2 EQU 33
CYDEV_CHIP_REVISION_4G_PRODUCTION EQU 17
CYDEV_CHIP_REVISION_4H_PRODUCTION EQU 0
CYDEV_CHIP_REVISION_4I_PRODUCTION EQU 0
CYDEV_CHIP_REVISION_4J_PRODUCTION EQU 0
CYDEV_CHIP_REVISION_4K_PRODUCTION EQU 0
CYDEV_CHIP_REVISION_4L_PRODUCTION EQU 0
CYDEV_CHIP_REVISION_4M_PRODUCTION EQU 0
CYDEV_CHIP_REVISION_4N_PRODUCTION EQU 0
CYDEV_CHIP_REVISION_4O_PRODUCTION EQU 0
CYDEV_CHIP_REVISION_4P_PRODUCTION EQU 0
CYDEV_CHIP_REVISION_4Q_PRODUCTION EQU 0
CYDEV_CHIP_REVISION_4R_PRODUCTION EQU 0
CYDEV_CHIP_REVISION_4S_PRODUCTION EQU 0
CYDEV_CHIP_REVISION_4T_PRODUCTION EQU 0
CYDEV_CHIP_REVISION_4U_PRODUCTION EQU 0
CYDEV_CHIP_REVISION_4V_PRODUCTION EQU 0
CYDEV_CHIP_REVISION_4W_PRODUCTION EQU 0
CYDEV_CHIP_REVISION_4X_PRODUCTION EQU 0
CYDEV_CHIP_REVISION_4Y_PRODUCTION EQU 0
CYDEV_CHIP_REVISION_4Z_PRODUCTION EQU 0
CYDEV_CHIP_REVISION_5A_ES0 EQU 0
CYDEV_CHIP_REVISION_5A_ES1 EQU 1
CYDEV_CHIP_REVISION_5A_PRODUCTION EQU 1
CYDEV_CHIP_REVISION_5B_ES0 EQU 0
CYDEV_CHIP_REVISION_5B_PRODUCTION EQU 0
CYDEV_CHIP_REVISION_6A_ES EQU 17
CYDEV_CHIP_REVISION_6A_NO_UDB EQU 33
CYDEV_CHIP_REVISION_6A_PRODUCTION EQU 33
CYDEV_CHIP_REVISION_FM3_PRODUCTION EQU 0
CYDEV_CHIP_REVISION_FM4_PRODUCTION EQU 0
CYDEV_CHIP_REVISION_PDL_FM0P_TYPE1_PRODUCTION EQU 0
CYDEV_CHIP_REVISION_PDL_FM0P_TYPE2_PRODUCTION EQU 0
CYDEV_CHIP_REVISION_PDL_FM0P_TYPE3_PRODUCTION EQU 0
CYDEV_CHIP_REVISION_USED EQU CYDEV_CHIP_REVISION_5B_PRODUCTION
CYDEV_CHIP_REV_EXPECT EQU CYDEV_CHIP_REVISION_USED
CYDEV_CONFIG_FASTBOOT_ENABLED EQU 1
CYDEV_CONFIG_UNUSED_IO_AllowButWarn EQU 0
CYDEV_CONFIG_UNUSED_IO EQU CYDEV_CONFIG_UNUSED_IO_AllowButWarn
CYDEV_CONFIG_UNUSED_IO_AllowWithInfo EQU 1
CYDEV_CONFIG_UNUSED_IO_Disallowed EQU 2
CYDEV_CONFIGURATION_COMPRESSED EQU 1
CYDEV_CONFIGURATION_DMA EQU 0
CYDEV_CONFIGURATION_ECC EQU 1
CYDEV_CONFIGURATION_IMOENABLED EQU CYDEV_CONFIG_FASTBOOT_ENABLED
CYDEV_CONFIGURATION_MODE_COMPRESSED EQU 0
CYDEV_CONFIGURATION_MODE EQU CYDEV_CONFIGURATION_MODE_COMPRESSED
CYDEV_CONFIGURATION_MODE_DMA EQU 2
CYDEV_CONFIGURATION_MODE_UNCOMPRESSED EQU 1
CYDEV_DEBUG_ENABLE_MASK EQU 0x20
CYDEV_DEBUG_ENABLE_REGISTER EQU CYREG_MLOGIC_DEBUG
CYDEV_DEBUGGING_DPS_Disable EQU 3
CYDEV_DEBUGGING_DPS_JTAG_4 EQU 1
CYDEV_DEBUGGING_DPS_JTAG_5 EQU 0
CYDEV_DEBUGGING_DPS_SWD EQU 2
CYDEV_DEBUGGING_DPS_SWD_SWV EQU 6
CYDEV_DEBUGGING_DPS EQU CYDEV_DEBUGGING_DPS_SWD_SWV
CYDEV_DEBUGGING_ENABLE EQU 1
CYDEV_DEBUGGING_XRES EQU 0
CYDEV_DMA_CHANNELS_AVAILABLE EQU 24
CYDEV_ECC_ENABLE EQU 0
CYDEV_HEAP_SIZE EQU 0x80
CYDEV_INSTRUCT_CACHE_ENABLED EQU 1
CYDEV_INTR_RISING EQU 0x00000007
CYDEV_IS_EXPORTING_CODE EQU 0
CYDEV_IS_IMPORTING_CODE EQU 0
CYDEV_PROJ_TYPE EQU 0
CYDEV_PROJ_TYPE_BOOTLOADER EQU 1
CYDEV_PROJ_TYPE_LAUNCHER EQU 5
CYDEV_PROJ_TYPE_LOADABLE EQU 2
CYDEV_PROJ_TYPE_LOADABLEANDBOOTLOADER EQU 4
CYDEV_PROJ_TYPE_MULTIAPPBOOTLOADER EQU 3
CYDEV_PROJ_TYPE_STANDARD EQU 0
CYDEV_PROTECTION_ENABLE EQU 0
CYDEV_STACK_SIZE EQU 0x0800
CYDEV_USE_BUNDLED_CMSIS EQU 1
CYDEV_VARIABLE_VDDA EQU 0
CYDEV_VDDA_MV EQU 5000
CYDEV_VDDD_MV EQU 5000
CYDEV_VDDIO0_MV EQU 5000
CYDEV_VDDIO1_MV EQU 5000
CYDEV_VDDIO2_MV EQU 5000
CYDEV_VDDIO3_MV EQU 5000
CYDEV_VIO0_MV EQU 5000
CYDEV_VIO1_MV EQU 5000
CYDEV_VIO2_MV EQU 5000
CYDEV_VIO3_MV EQU 5000
CYIPBLOCK_ARM_CM3_VERSION EQU 0
CYIPBLOCK_P3_ANAIF_VERSION EQU 0
CYIPBLOCK_P3_CAN_VERSION EQU 0
CYIPBLOCK_P3_CAPSENSE_VERSION EQU 0
CYIPBLOCK_P3_COMP_VERSION EQU 0
CYIPBLOCK_P3_DECIMATOR_VERSION EQU 0
CYIPBLOCK_P3_DFB_VERSION EQU 0
CYIPBLOCK_P3_DMA_VERSION EQU 0
CYIPBLOCK_P3_DRQ_VERSION EQU 0
CYIPBLOCK_P3_DSM_VERSION EQU 0
CYIPBLOCK_P3_EMIF_VERSION EQU 0
CYIPBLOCK_P3_I2C_VERSION EQU 0
CYIPBLOCK_P3_LCD_VERSION EQU 0
CYIPBLOCK_P3_LPF_VERSION EQU 0
CYIPBLOCK_P3_OPAMP_VERSION EQU 0
CYIPBLOCK_P3_PM_VERSION EQU 0
CYIPBLOCK_P3_SCCT_VERSION EQU 0
CYIPBLOCK_P3_TIMER_VERSION EQU 0
CYIPBLOCK_P3_USB_VERSION EQU 0
CYIPBLOCK_P3_VIDAC_VERSION EQU 0
CYIPBLOCK_P3_VREF_VERSION EQU 0
CYIPBLOCK_S8_GPIO_VERSION EQU 0
CYIPBLOCK_S8_IRQ_VERSION EQU 0
CYIPBLOCK_S8_SAR_VERSION EQU 0
CYIPBLOCK_S8_SIO_VERSION EQU 0
CYIPBLOCK_S8_UDB_VERSION EQU 0
DMA_CHANNELS_USED__MASK0 EQU 0x00000000
CYDEV_BOOTLOADER_ENABLE EQU 0

#endif /* INCLUDED_CYFITTERIAR_INC */
